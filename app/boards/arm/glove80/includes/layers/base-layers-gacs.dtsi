        layer_QWERTY_GACS {
            bindings = <
               &kp F1                        &kp F2                        &kp F3                        &kp F4                        &kp F5                                                                                                                                                                                                     &kp F6                         &kp F7                         &kp F8                            &kp F9               &kp F10
               &kp N0                        &kp N1                        &kp N2                        &kp N3                        &kp N4  &kp N5                                                                                                                                                              &kp N6                         &kp N7                         &kp N8                         &kp N9                           &kp F12               &kp F11
            &kp GRAVE                         &kp Q                         &kp W  &LeftMiddyExtendUp (E, LAYER_QWERTY_GACS)                         &kp R   &kp T                                                                                                                                                               &kp Y                          &kp U   &MiddyExtendUp (I, LAYER_QWERTY_GACS)                          &kp O                             &kp P             &kp MINUS
            &kp EQUAL  &LeftPinky (A, LAYER_QWERTY_GACS)  &LeftRingy (S, LAYER_QWERTY_GACS)  &LeftMiddy (D, LAYER_QWERTY_GACS)  &LeftIndex (F, LAYER_QWERTY_GACS)   &kp G                                                                                                                                                               &kp H  &RightIndex (J, LAYER_QWERTY_GACS)  &RightMiddy (K, LAYER_QWERTY_GACS)  &RightRingy (L, LAYER_QWERTY_GACS)  &RightPinky (SEMI, LAYER_QWERTY_GACS)               &kp SQT
      &mo LAYER_Lower                         &kp Z                         &kp X  &LeftMiddyExtendDown (C, LAYER_QWERTY_GACS)                         &kp V   &kp B      &thumb LAYER_Function ESC                &parang_left               &parang_right         &kp _HOME                &kp _END  &thumb LAYER_System ENTER   &kp N                          &kp M  &MiddyExtendDown (COMMA, LAYER_QWERTY_GACS)                        &kp DOT                          &kp FSLH       &mo LAYER_Lower
 &magic LAYER_Magic 0                     &kp GRAVE                      &kp LBKT                      &kp RBKT       &thumb LAYER_Emoji BSLH          &thumb LAYER_Cursor BACKSPACE  &thumb LAYER_Number DELETE  &thumb LAYER_Typing INSERT  &mo LAYER_Typing  &thumb LAYER_Mouse TAB  &space LAYER_Symbol SPACE             &thumb LAYER_World PAGE_UP           &msc MOUSE_SCROLL_UP         &msc MOUSE_SCROLL_DOWN                         &lt LAYER_MouseWarp PG_DN  &magic LAYER_Magic 0
            >;
        };
