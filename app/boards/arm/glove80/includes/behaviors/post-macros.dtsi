/*HACK*/};
#if EMOJI_GENDER_SIGN_PRESET == 'N'
  emoji_gender_sign_preset: &none {};
#elif EMOJI_GENDER_SIGN_PRESET == 'M'
  emoji_gender_sign_preset: &emoji_male_sign {};
#elif EMOJI_GENDER_SIGN_PRESET == 'F'
  emoji_gender_sign_preset: &emoji_female_sign {};
#endif

#if EMOJI_SKIN_TONE_PRESET == 'N'
  emoji_skin_tone_preset: &none {};
#elif EMOJI_SKIN_TONE_PRESET == 'L'
  emoji_skin_tone_preset: &emoji_light_skin_tone {};
#elif EMOJI_SKIN_TONE_PRESET == 'l'
  emoji_skin_tone_preset: &emoji_medium_light_skin_tone {};
#elif EMOJI_SKIN_TONE_PRESET == 'M'
  emoji_skin_tone_preset: &emoji_medium_skin_tone {};
#elif EMOJI_SKIN_TONE_PRESET == 'd'
  emoji_skin_tone_preset: &emoji_medium_dark_skin_tone {};
#elif EMOJI_SKIN_TONE_PRESET == 'D'
  emoji_skin_tone_preset: &emoji_dark_skin_tone {};
#endif

#if EMOJI_HAIR_STYLE_PRESET == 'N'
  emoji_hair_style_preset: &none {};
#elif EMOJI_HAIR_STYLE_PRESET == 'B'
  emoji_hair_style_preset: &emoji_bald {};
#elif EMOJI_HAIR_STYLE_PRESET == 'R'
  emoji_hair_style_preset: &emoji_red_hair {};
#elif EMOJI_HAIR_STYLE_PRESET == 'C'
  emoji_hair_style_preset: &emoji_curly_hair {};
#elif EMOJI_HAIR_STYLE_PRESET == 'W'
  emoji_hair_style_preset: &emoji_white_hair {};
#endif
/*HACK*//{

//////////////////////////////////////////////////////////////////////////
//
// Mouse keys (keyboard mouse control) requires v24.12 firmware or newer:
// override the "HID_POINTING" setting to "y" in Advanced Configuration
// and then select "v24.12" firmware from the drop-down menu located at
// Glove80 Layout Editor > Settings > Advanced Settings > Firmware Version
//
// Alternatively, you can use either PR36 or PR23 beta firmware for this:
// select "community.pr36.mouse-keys" from the drop-down menu located at
// Glove80 Layout Editor > Settings > Advanced Settings > Firmware Version
//
// - https://github.com/moergo-sc/zmk/pull/36
// - https://github.com/moergo-sc/zmk/pull/23
// - https://gist.github.com/krissen/dd27082e7ab0575619c7a31f4d2ec7ae
// - https://github.com/zmkfirmware/zmk/compare/main...urob:zmk:mouse-3.2
// - https://github.com/caksoylar/zmk-config/commit/0020c23c544cd7111013f0114609d1fb90e0e475
// - https://github.com/caksoylar/zmk-config/commit/e35ee2f08788927683df7bbdd7fc73434473886e
//
//////////////////////////////////////////////////////////////////////////

//
// NATURAL_SCROLLING reverses the directionality of the mouse scroll wheel
// to support "natural scrolling" in macOS and other desktop environments.
//
//#define NATURAL_SCROLLING

#ifdef NATURAL_SCROLLING
  #define MOUSE_SCROLL_UP    SCRL_DOWN
  #define MOUSE_SCROLL_DOWN  SCRL_UP
  #define MOUSE_SCROLL_LEFT  SCRL_RIGHT
  #define MOUSE_SCROLL_RIGHT SCRL_LEFT
#else
  #define MOUSE_SCROLL_UP    SCRL_UP
  #define MOUSE_SCROLL_DOWN  SCRL_DOWN
  #define MOUSE_SCROLL_LEFT  SCRL_LEFT
  #define MOUSE_SCROLL_RIGHT SCRL_RIGHT
#endif

//
// MOUSE_MOTION_DELAY defines how long to wait (milliseconds) before starting
// to move the mouse pointer.
//
#ifndef MOUSE_MOTION_DELAY
#define MOUSE_MOTION_DELAY 0
#endif

//
// MOUSE_MOTION_ACCELERATION_EXPONENT sets how the mouse pointer accelerates:
//
// acceleration exponent 0: uniform speed
// acceleration exponent 1: uniform acceleration
// acceleration exponent 2: uniform jerk
//
#ifndef MOUSE_MOTION_ACCELERATION_EXPONENT
#define MOUSE_MOTION_ACCELERATION_EXPONENT 1
#endif

//
// MOUSE_MOTION_TIME_TO_MAXIMUM_SPEED defines how long to wait (milliseconds)
// before the mouse pointer speed is suddenly boosted to the maximum value.
//
#ifndef MOUSE_MOTION_TIME_TO_MAXIMUM_SPEED
#define MOUSE_MOTION_TIME_TO_MAXIMUM_SPEED 300
#endif

//
// MOUSE_MOTION_MAXIMUM_SPEED defines how quickly the mouse pointer can move.
//
#ifndef MOUSE_MOTION_MAXIMUM_SPEED
#define MOUSE_MOTION_MAXIMUM_SPEED 600
#endif

//
// MOUSE_SCROLL_DELAY defines how long to wait (milliseconds) before starting
// to move the mouse pointer.
//
#ifndef MOUSE_SCROLL_DELAY
#define MOUSE_SCROLL_DELAY 0
#endif

//
// MOUSE_SCROLL_ACCELERATION_EXPONENT sets how the mouse pointer accelerates:
//
// acceleration exponent 0: uniform speed
// acceleration exponent 1: uniform acceleration
// acceleration exponent 2: uniform jerk
//
#ifndef MOUSE_SCROLL_ACCELERATION_EXPONENT
#define MOUSE_SCROLL_ACCELERATION_EXPONENT 0
#endif

//
// MOUSE_SCROLL_TIME_TO_MAXIMUM_SPEED defines how long to wait (milliseconds)
// before the mouse pointer speed is suddenly boosted to the maximum value.
//
#ifndef MOUSE_SCROLL_TIME_TO_MAXIMUM_SPEED
#define MOUSE_SCROLL_TIME_TO_MAXIMUM_SPEED 300
#endif

//
// MOUSE_SCROLL_MAXIMUM_SPEED defines how quickly the mouse wheel can scroll.
//
#ifndef MOUSE_SCROLL_MAXIMUM_SPEED
#define MOUSE_SCROLL_MAXIMUM_SPEED 10
#endif

//
// MOUSE_SCALER_FINE sets parameters for the &zip_xy_scaler input processor:
// https://zmk.dev/docs/keymaps/input-processors/scaler
//
#ifndef MOUSE_SCALER_FINE
#define MOUSE_SCALER_FINE 1 16
#endif

//
// MOUSE_SCALER_SLOW sets parameters for the &zip_xy_scaler input processor:
// https://zmk.dev/docs/keymaps/input-processors/scaler
//
#ifndef MOUSE_SCALER_SLOW
#define MOUSE_SCALER_SLOW 1 4
#endif

//
// MOUSE_SCALER_FAST sets parameters for the &zip_xy_scaler input processor:
// https://zmk.dev/docs/keymaps/input-processors/scaler
//
#ifndef MOUSE_SCALER_FAST
#define MOUSE_SCALER_FAST 4 1
#endif

//
// MOUSE_SCALER_WARP sets parameters for the &zip_xy_scaler input processor:
// https://zmk.dev/docs/keymaps/input-processors/scaler
//
#ifndef MOUSE_SCALER_WARP
#define MOUSE_SCALER_WARP 12 1
#endif
/*HACK*/};
#ifdef ENABLE_MOUSE_KEYS
  // ==== MOUSE-KEY <section begins> ====
  #undef ZMK_POINTING_DEFAULT_MOVE_VAL
  #undef ZMK_POINTING_DEFAULT_SCRL_VAL
  #define ZMK_POINTING_DEFAULT_MOVE_VAL MOUSE_MOTION_MAXIMUM_SPEED
  #define ZMK_POINTING_DEFAULT_SCRL_VAL MOUSE_SCROLL_MAXIMUM_SPEED
  #include <dt-bindings/zmk/pointing.h>
  &mmv {
    delay-ms = <MOUSE_MOTION_DELAY>;
    acceleration-exponent = <MOUSE_MOTION_ACCELERATION_EXPONENT>;
    time-to-max-speed-ms = <MOUSE_MOTION_TIME_TO_MAXIMUM_SPEED>;
  };
  &msc {
    delay-ms = <MOUSE_SCROLL_DELAY>;
    acceleration-exponent = <MOUSE_SCROLL_ACCELERATION_EXPONENT>;
    time-to-max-speed-ms = <MOUSE_SCROLL_TIME_TO_MAXIMUM_SPEED>;
  };
  //
  // Scaling for mouse movement, based on @caksoylar's example:
  // https://github.com/caksoylar/zmk-config/commit/0020c23c544cd7111013f0114609d1fb90e0e475
  //
  #include <input/processors.dtsi>
  &mmv_input_listener {
    #ifdef LAYER_MouseFine
    fine {
      layers = <LAYER_MouseFine>;
      input-processors = <&zip_xy_scaler MOUSE_SCALER_FINE>;
    };
    #endif
    #ifdef LAYER_MouseSlow
    slow {
      layers = <LAYER_MouseSlow>;
      input-processors = <&zip_xy_scaler MOUSE_SCALER_SLOW>;
    };
    #endif
    #ifdef LAYER_MouseFast
    fast {
      layers = <LAYER_MouseFast>;
      input-processors = <&zip_xy_scaler MOUSE_SCALER_FAST>;
    };
    #endif
    #ifdef LAYER_MouseWarp
    warp {
      layers = <LAYER_MouseWarp>;
      input-processors = <&zip_xy_scaler MOUSE_SCALER_WARP>;
    };
    #endif
  };
  //
  // Scaling for mouse scrolling, based on @caksoylar's example:
  // https://github.com/caksoylar/zmk-config/commit/e35ee2f08788927683df7bbdd7fc73434473886e
  //
  #include <zephyr/dt-bindings/input/input-event-codes.h>
  / {
    input_processors {
      zip_scroll_scaling_processor: zip_scroll_scaling_processor {
        compatible = "zmk,input-processor-scaler";
        #input-processor-cells = <2>;
        type = <INPUT_EV_REL>;
        codes = <INPUT_REL_WHEEL INPUT_REL_HWHEEL>;
        track-remainders;
      };
    };
  };
  &msc_input_listener {
    #ifdef LAYER_MouseFine
    fine {
      layers = <LAYER_MouseFine>;
      input-processors = <&zip_scroll_scaling_processor MOUSE_SCALER_FINE>;
    };
    #endif
    #ifdef LAYER_MouseSlow
    slow {
      layers = <LAYER_MouseSlow>;
      input-processors = <&zip_scroll_scaling_processor MOUSE_SCALER_SLOW>;
    };
    #endif
    #ifdef LAYER_MouseFast
    fast {
      layers = <LAYER_MouseFast>;
      input-processors = <&zip_scroll_scaling_processor MOUSE_SCALER_FAST>;
    };
    #endif
    #ifdef LAYER_MouseWarp
    warp {
      layers = <LAYER_MouseWarp>;
      input-processors = <&zip_scroll_scaling_processor MOUSE_SCALER_WARP>;
    };
    #endif
  };
  // ==== MOUSE-KEY <section ends> =====
#else
  #define mkp none
  #define mmv none
  #define msc none
  #define LCLK
  #define MCLK
  #define RCLK
  #define MB1
  #define MB2
  #define MB3
  #define MB4
  #define MB5
  #define MOVE_UP
  #define MOVE_DOWN
  #define MOVE_LEFT
  #define MOVE_RIGHT
  #define SCRL_UP
  #define SCRL_DOWN
  #define SCRL_LEFT
  #define SCRL_RIGHT
#endif
/*HACK*//{

};

/* Generated input processors */


/* Automatically generated macro definitions */
/ {
    macros {

    };
};

/* Automatically generated behavior definitions */
/ {
    behaviors {


    };
};
