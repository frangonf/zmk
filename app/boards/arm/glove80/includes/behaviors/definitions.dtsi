/ {
    behaviors {
        magic: magic {
            compatible = "zmk,behavior-hold-tap";
            label = "MAGIC_HOLD_TAP";
            #binding-cells = <2>;
            flavor = "tap-preferred";
            tapping-term-ms = <200>;
            bindings = <&mo>, <&rgb_ug_status_macro>;
        };
    };
};

/* #define for key positions */
#define POS_LH_T1 52
#define POS_LH_T2 53
#define POS_LH_T3 54
#define POS_LH_T4 69
#define POS_LH_T5 70
#define POS_LH_T6 71
#define POS_LH_C1R2 15
#define POS_LH_C1R3 27
#define POS_LH_C1R4 39
#define POS_LH_C1R5 51
#define POS_LH_C2R1 4
#define POS_LH_C2R2 14
#define POS_LH_C2R3 26
#define POS_LH_C2R4 38
#define POS_LH_C2R5 50
#define POS_LH_C2R6 68
#define POS_LH_C3R1 3
#define POS_LH_C3R2 13
#define POS_LH_C3R3 25
#define POS_LH_C3R4 37
#define POS_LH_C3R5 49
#define POS_LH_C3R6 67
#define POS_LH_C4R1 2
#define POS_LH_C4R2 12
#define POS_LH_C4R3 24
#define POS_LH_C4R4 36
#define POS_LH_C4R5 48
#define POS_LH_C4R6 66
#define POS_LH_C5R1 1
#define POS_LH_C5R2 11
#define POS_LH_C5R3 23
#define POS_LH_C5R4 35
#define POS_LH_C5R5 47
#define POS_LH_C5R6 65
#define POS_LH_C6R1 0
#define POS_LH_C6R2 10
#define POS_LH_C6R3 22
#define POS_LH_C6R4 34
#define POS_LH_C6R5 46
#define POS_LH_C6R6 64
#define POS_RH_T1 57
#define POS_RH_T2 56
#define POS_RH_T3 55
#define POS_RH_T4 74
#define POS_RH_T5 73
#define POS_RH_T6 72
#define POS_RH_C1R2 16
#define POS_RH_C1R3 28
#define POS_RH_C1R4 40
#define POS_RH_C1R5 58
#define POS_RH_C2R1 5
#define POS_RH_C2R2 17
#define POS_RH_C2R3 29
#define POS_RH_C2R4 41
#define POS_RH_C2R5 59
#define POS_RH_C2R6 75
#define POS_RH_C3R1 6
#define POS_RH_C3R2 18
#define POS_RH_C3R3 30
#define POS_RH_C3R4 42
#define POS_RH_C3R5 60
#define POS_RH_C3R6 76
#define POS_RH_C4R1 7
#define POS_RH_C4R2 19
#define POS_RH_C4R3 31
#define POS_RH_C4R4 43
#define POS_RH_C4R5 61
#define POS_RH_C4R6 77
#define POS_RH_C5R1 8
#define POS_RH_C5R2 20
#define POS_RH_C5R3 32
#define POS_RH_C5R4 44
#define POS_RH_C5R5 62
#define POS_RH_C5R6 78
#define POS_RH_C6R1 9
#define POS_RH_C6R2 21
#define POS_RH_C6R3 33
#define POS_RH_C6R4 45
#define POS_RH_C6R5 63
#define POS_RH_C6R6 79

/* Custom Defined Behaviors */
/ {
// NOTE: Use the many #define settings below to customize this keymap!
#define OPERATING_SYSTEM 'M' // choose 'L'inux, 'M'acOS, or 'W'indows
#define DIFFICULTY_LEVEL  0  // 0:custom, 1:easy -> 5:hard (see below)
#define ENFORCE_BILATERAL    // cancels single-handed home row mod+tap
#define ENFORCE_BILATERAL_LINUX  // cancels single-handed home row mod+tap for Linux layers
//#define MACOS_CAGS_EXTEND  // adds extended Ctrl keys on E,C,I,COMMA (macOS only)
#define ENABLE_MOUSE_KEYS  // requires HID_POINTING override to "y"
//#define SPACE_FORGIVENESS  // allow lingering taps on the space bar
//#define THUMB_FORGIVENESS  // allow lingering taps on the thumb keys
//#define SHIFT_FORGIVENESS  // requires v24.08-beta or newer firmware
//#define NATURAL_SCROLLING  // supports "natural scrolling" in macOS
//#define WORLD_USE_COMPOSE  // use native Compose in place of Unicode
//#define WORLD_HOST_AZERTY  // host computer is set to AZERTY locale
//#define WORLD_SHIFT_NUMBER // apply Shift to type number row digits
// TIP: Add more setting overrides here instead of editing them below.

//////////////////////////////////////////////////////////////////////////////
//
// Sunaku's Keymap v42 -- "Glorious Engrammer"
// - https://github.com/sunaku/glove80-keymaps
//
//////////////////////////////////////////////////////////////////////////////

//
// OPERATING_SYSTEM defines which operating system you intend to use
// with this keymap, because shortcuts vary across operating systems.
//
// - https://zmk.dev/docs/codes
// - https://en.wikipedia.org/wiki/Table_of_keyboard_shortcuts
//
// This setting also affects the UNICODE() function defined below, as
// each OS has different shortcuts for typing Unicode hex characters.
//
// NOTE: You may need to enable Unicode hexadecimal input in your OS:
// - (macOS) https://uknowit.uwgb.edu/page.php?id=22623
//     and   https://github.com/ldanet/unicode-hex-input-fix
// - (Linux) https://help.ubuntu.com/stable/ubuntu-help/tips-specialchars.html.en#ctrlshiftu
// - (Windows) https://github.com/samhocevar/wincompose
//
// Specifically, Windows users should be running the WinCompose tool,
// which lets you type Unicode characters via hexadecimal codepoints.
//
#ifndef OPERATING_SYSTEM
  #define OPERATING_SYSTEM 'L' // linux
//#define OPERATING_SYSTEM 'M' // macos
//#define OPERATING_SYSTEM 'W' // windows
#endif
#if OPERATING_SYSTEM == 'M'
  #define _C      LG
  #define _A_TAB  LGUI
  #define _G_TAB  LALT
  #define _REDO   LG(LS(Z))
  #define _POWER  K_POWER
  #define _WORD   LA
  #define _HOME   LG(LEFT)
  #define _END    LG(RIGHT)
  #define _EMOJI  LG(LC(SPACE))
  #define _FILES  LS(LA(M))
  #define _GLOBE  GLOBE
#else
  #define _C      LC
  #define _A_TAB  LALT
  #define _G_TAB  LGUI
  #define _REDO   LC(Y)
  #define _POWER  C_POWER
  #define _WORD   LC
  #define _HOME   HOME
  #define _END    END
  #define _EMOJI  LG(DOT)
  #define _FILES  LG(E)
  #define _GLOBE  LGUI
#endif
#define _SLEEP      C_SLEEP
#if OPERATING_SYSTEM == 'W'
  #define _LOCK   LG(L)
#elif OPERATING_SYSTEM == 'M'
  #define _LOCK   _C(LC(Q))
#elif OPERATING_SYSTEM == 'L'
  #define _LOCK   K_LOCK
#endif
#define _UNDO       _C(Z)
#define _CUT        _C(X)
#define _COPY       _C(C)
#define _PASTE      _C(V)
#define _FIND       _C(F)
#define _FIND_NEXT  _C(G)
#define _FIND_PREV  _C(LS(G))
#define _REPLACE    LG(LA(F))

//
// Linux-specific shortcuts (use Ctrl instead of Cmd)
// For use in Linux layers (32-63)
//
#define _LINUX_C      LC
#define _LINUX_UNDO   LC(Z)
#define _LINUX_CUT    LC(X)
#define _LINUX_COPY   LC(C)
#define _LINUX_PASTE  LC(V)
#define _LINUX_FIND   LC(F)
#define _LINUX_FIND_NEXT  LC(G)
#define _LINUX_FIND_PREV  LC(LS(G))
#define _LINUX_REPLACE    LC(H)
#define _LINUX_REDO   LC(Y)
#define _LINUX_HOME   HOME
#define _LINUX_END    END
#define _LINUX_EMOJI  LG(DOT)
#define _LINUX_FILES  LG(E)

//
// Keymap specific knowledge of the base layer's alpha + ZMK layout
//
#if defined(LAYER_Enthium) && LAYER_Enthium == 0
  #define KEY_LH_C6R1 0
  #define KEY_LH_C5R1 0
  #define KEY_LH_C4R1 0
  #define KEY_LH_C3R1 0
  #define KEY_LH_C2R1 0
  #define KEY_RH_C2R1 0
  #define KEY_RH_C3R1 0
  #define KEY_RH_C4R1 0
  #define KEY_RH_C5R1 0
  #define KEY_RH_C6R1 0
  #define KEY_LH_C6R2 0
  #define KEY_LH_C5R2 N1
  #define KEY_LH_C4R2 N2
  #define KEY_LH_C3R2 N3
  #define KEY_LH_C2R2 N4
  #define KEY_LH_C1R2 N5
  #define KEY_RH_C1R2 N6
  #define KEY_RH_C2R2 N7
  #define KEY_RH_C3R2 N8
  #define KEY_RH_C4R2 N9
  #define KEY_RH_C5R2 N0
  #define KEY_RH_C6R2 0
  #define KEY_LH_C6R3 0
  #define KEY_LH_C5R3 Z
  #define KEY_LH_C4R3 Y
  #define KEY_LH_C3R3 U
  #define KEY_LH_C2R3 O
  #define KEY_LH_C1R3 SEMI
  #define KEY_RH_C1R3 Q
  #define KEY_RH_C2R3 L
  #define KEY_RH_C3R3 D
  #define KEY_RH_C4R3 P
  #define KEY_RH_C5R3 X
  #define KEY_RH_C6R3 0
  #define KEY_LH_C6R4 W
  #define KEY_LH_C5R4 C
  #define KEY_LH_C4R4 I
  #define KEY_LH_C3R4 E
  #define KEY_LH_C2R4 A
  #define KEY_LH_C1R4 COMMA
  #define KEY_RH_C1R4 K
  #define KEY_RH_C2R4 H
  #define KEY_RH_C3R4 T
  #define KEY_RH_C4R4 N
  #define KEY_RH_C5R4 S
  #define KEY_RH_C6R4 F
  #define KEY_LH_C6R5 0
  #define LAY_LH_C6R5 LAYER_Lower
  #define KEY_LH_C5R5 SQT
  #define KEY_LH_C4R5 MINUS
  #define KEY_LH_C3R5 EQUAL
  #define KEY_LH_C2R5 DOT
  #define KEY_LH_C1R5 FSLH
  #define KEY_LH_T1 ESC
  #define LAY_LH_T1 LAYER_Function
  #define KEY_LH_T2 LPAR
  #define KEY_LH_T3 RPAR
  #define KEY_RH_T3 _HOME
  #define KEY_RH_T2 _END
  #define KEY_RH_T1 ENTER
  #define LAY_RH_T1 LAYER_System
  #define KEY_RH_C1R5 J
  #define KEY_RH_C2R5 M
  #define KEY_RH_C3R5 G
  #define KEY_RH_C4R5 B
  #define KEY_RH_C5R5 V
  #define KEY_RH_C6R5 0
  #define LAY_RH_C6R5 LAYER_Lower
  #define KEY_LH_C6R6 0
  #define KEY_LH_C5R6 GRAVE
  #define KEY_LH_C4R6 LBKT
  #define KEY_LH_C3R6 RBKT
  #define KEY_LH_C2R6 BSLH
  #define LAY_LH_C2R6 LAYER_Emoji
  #define KEY_LH_T4 SPACE
  #define LAY_LH_T4 LAYER_Cursor
  #define KEY_LH_T5 TAB
  #define LAY_LH_T5 LAYER_Number
  #define KEY_LH_T6 INSERT
  #define LAY_LH_T6 LAYER_Typing
  #define KEY_RH_T6 DELETE
  #define LAY_RH_T6 LAYER_Typing
  #define KEY_RH_T5 BACKSPACE
  #define LAY_RH_T5 LAYER_Mouse
  #define KEY_RH_T4 R
  #define LAY_RH_T4 LAYER_Symbol
  #define KEY_RH_C2R6 PAGE_UP
  #define LAY_RH_C2R6 LAYER_World
  #define KEY_RH_C3R6 MOUSE_SCROLL_UP
  #define KEY_RH_C4R6 MOUSE_SCROLL_DOWN
  #define KEY_RH_C5R6 PG_DN
  #define KEY_RH_C6R6 0
#endif
#if defined(LAYER_Engrammer) && LAYER_Engrammer == 0
  #define KEY_LH_C6R1 0
  #define KEY_LH_C5R1 0
  #define KEY_LH_C4R1 0
  #define KEY_LH_C3R1 0
  #define KEY_LH_C2R1 0
  #define KEY_RH_C2R1 0
  #define KEY_RH_C3R1 0
  #define KEY_RH_C4R1 0
  #define KEY_RH_C5R1 0
  #define KEY_RH_C6R1 0
  #define KEY_LH_C6R2 0
  #define KEY_LH_C5R2 N1
  #define KEY_LH_C4R2 N2
  #define KEY_LH_C3R2 N3
  #define KEY_LH_C2R2 N4
  #define KEY_LH_C1R2 N5
  #define KEY_RH_C1R2 N6
  #define KEY_RH_C2R2 N7
  #define KEY_RH_C3R2 N8
  #define KEY_RH_C4R2 N9
  #define KEY_RH_C5R2 N0
  #define KEY_RH_C6R2 0
  #define KEY_LH_C6R3 0
  #define KEY_LH_C5R3 B
  #define KEY_LH_C4R3 Y
  #define KEY_LH_C3R3 O
  #define KEY_LH_C2R3 U
  #define KEY_LH_C1R3 SQT
  #define KEY_RH_C1R3 SEMI
  #define KEY_RH_C2R3 L
  #define KEY_RH_C3R3 D
  #define KEY_RH_C4R3 W
  #define KEY_RH_C5R3 V
  #define KEY_RH_C6R3 Z
  #define KEY_LH_C6R4 EQUAL
  #define KEY_LH_C5R4 C
  #define KEY_LH_C4R4 I
  #define KEY_LH_C3R4 E
  #define KEY_LH_C2R4 A
  #define KEY_LH_C1R4 COMMA
  #define KEY_RH_C1R4 DOT
  #define KEY_RH_C2R4 H
  #define KEY_RH_C3R4 T
  #define KEY_RH_C4R4 S
  #define KEY_RH_C5R4 N
  #define KEY_RH_C6R4 Q
  #define KEY_LH_C6R5 0
  #define LAY_LH_C6R5 LAYER_Lower
  #define KEY_LH_C5R5 G
  #define KEY_LH_C4R5 X
  #define KEY_LH_C3R5 J
  #define KEY_LH_C2R5 K
  #define KEY_LH_C1R5 MINUS
  #define KEY_LH_T1 ESC
  #define LAY_LH_T1 LAYER_Function
  #define KEY_LH_T2 LPAR
  #define KEY_LH_T3 RPAR
  #define KEY_RH_T3 _HOME
  #define KEY_RH_T2 _END
  #define KEY_RH_T1 ENTER
  #define LAY_RH_T1 LAYER_System
  #define KEY_RH_C1R5 FSLH
  #define KEY_RH_C2R5 R
  #define KEY_RH_C3R5 M
  #define KEY_RH_C4R5 F
  #define KEY_RH_C5R5 P
  #define KEY_RH_C6R5 0
  #define LAY_RH_C6R5 LAYER_Lower
  #define KEY_LH_C6R6 0
  #define KEY_LH_C5R6 GRAVE
  #define KEY_LH_C4R6 LBKT
  #define KEY_LH_C3R6 RBKT
  #define KEY_LH_C2R6 BSLH
  #define LAY_LH_C2R6 LAYER_Emoji
  #define KEY_LH_T4 BACKSPACE
  #define LAY_LH_T4 LAYER_Cursor
  #define KEY_LH_T5 DELETE
  #define LAY_LH_T5 LAYER_Number
  #define KEY_LH_T6 INSERT
  #define LAY_LH_T6 LAYER_Typing
  #define KEY_RH_T6 0
  #define LAY_RH_T6 LAYER_Typing
  #define KEY_RH_T5 TAB
  #define LAY_RH_T5 LAYER_Mouse
  #define KEY_RH_T4 SPACE
  #define LAY_RH_T4 LAYER_Symbol
  #define KEY_RH_C2R6 PAGE_UP
  #define LAY_RH_C2R6 LAYER_World
  #define KEY_RH_C3R6 MOUSE_SCROLL_UP
  #define KEY_RH_C4R6 MOUSE_SCROLL_DOWN
  #define KEY_RH_C5R6 PG_DN
  #define KEY_RH_C6R6 0
#endif
#if defined(LAYER_Engram) && LAYER_Engram == 0
  #define KEY_LH_C6R1 0
  #define KEY_LH_C5R1 0
  #define KEY_LH_C4R1 0
  #define KEY_LH_C3R1 0
  #define KEY_LH_C2R1 0
  #define KEY_RH_C2R1 0
  #define KEY_RH_C3R1 0
  #define KEY_RH_C4R1 0
  #define KEY_RH_C5R1 0
  #define KEY_RH_C6R1 0
  #define KEY_LH_C6R2 0
  #define KEY_LH_C5R2 N1
  #define KEY_LH_C4R2 N2
  #define KEY_LH_C3R2 N3
  #define KEY_LH_C2R2 N4
  #define KEY_LH_C1R2 N5
  #define KEY_RH_C1R2 N6
  #define KEY_RH_C2R2 N7
  #define KEY_RH_C3R2 N8
  #define KEY_RH_C4R2 N9
  #define KEY_RH_C5R2 N0
  #define KEY_RH_C6R2 0
  #define KEY_LH_C6R3 0
  #define KEY_LH_C5R3 B
  #define KEY_LH_C4R3 Y
  #define KEY_LH_C3R3 O
  #define KEY_LH_C2R3 U
  #define KEY_LH_C1R3 SQT
  #define KEY_RH_C1R3 DQT
  #define KEY_RH_C2R3 L
  #define KEY_RH_C3R3 D
  #define KEY_RH_C4R3 W
  #define KEY_RH_C5R3 V
  #define KEY_RH_C6R3 Z
  #define KEY_LH_C6R4 HASH
  #define KEY_LH_C5R4 C
  #define KEY_LH_C4R4 I
  #define KEY_LH_C3R4 E
  #define KEY_LH_C2R4 A
  #define KEY_LH_C1R4 COMMA
  #define KEY_RH_C1R4 DOT
  #define KEY_RH_C2R4 H
  #define KEY_RH_C3R4 T
  #define KEY_RH_C4R4 S
  #define KEY_RH_C5R4 N
  #define KEY_RH_C6R4 Q
  #define KEY_LH_C6R5 0
  #define LAY_LH_C6R5 LAYER_Lower
  #define KEY_LH_C5R5 G
  #define KEY_LH_C4R5 X
  #define KEY_LH_C3R5 J
  #define KEY_LH_C2R5 K
  #define KEY_LH_C1R5 MINUS
  #define KEY_LH_T1 ESC
  #define LAY_LH_T1 LAYER_Function
  #define KEY_LH_T2 LPAR
  #define KEY_LH_T3 RPAR
  #define KEY_RH_T3 _HOME
  #define KEY_RH_T2 _END
  #define KEY_RH_T1 ENTER
  #define LAY_RH_T1 LAYER_System
  #define KEY_RH_C1R5 QMARK
  #define KEY_RH_C2R5 R
  #define KEY_RH_C3R5 M
  #define KEY_RH_C4R5 F
  #define KEY_RH_C5R5 P
  #define KEY_RH_C6R5 0
  #define LAY_RH_C6R5 LAYER_Lower
  #define KEY_LH_C6R6 0
  #define KEY_LH_C5R6 FSLH
  #define KEY_LH_C4R6 LBKT
  #define KEY_LH_C3R6 RBKT
  #define KEY_LH_C2R6 AT
  #define KEY_LH_T4 BACKSPACE
  #define LAY_LH_T4 LAYER_Cursor
  #define KEY_LH_T5 DELETE
  #define LAY_LH_T5 LAYER_Number
  #define KEY_LH_T6 INSERT
  #define LAY_LH_T6 LAYER_Typing
  #define KEY_RH_T6 0
  #define LAY_RH_T6 LAYER_Typing
  #define KEY_RH_T5 TAB
  #define LAY_RH_T5 LAYER_Mouse
  #define KEY_RH_T4 SPACE
  #define LAY_RH_T4 LAYER_Symbol
  #define KEY_RH_C2R6 PAGE_UP
  #define LAY_RH_C2R6 LAYER_World
  #define KEY_RH_C3R6 MOUSE_SCROLL_UP
  #define KEY_RH_C4R6 MOUSE_SCROLL_DOWN
  #define KEY_RH_C5R6 PG_DN
  #define KEY_RH_C6R6 0
#endif
#if defined(LAYER_Dvorak) && LAYER_Dvorak == 0
  #define KEY_LH_C6R1 0
  #define KEY_LH_C5R1 0
  #define KEY_LH_C4R1 0
  #define KEY_LH_C3R1 0
  #define KEY_LH_C2R1 0
  #define KEY_RH_C2R1 0
  #define KEY_RH_C3R1 0
  #define KEY_RH_C4R1 0
  #define KEY_RH_C5R1 0
  #define KEY_RH_C6R1 0
  #define KEY_LH_C6R2 0
  #define KEY_LH_C5R2 N1
  #define KEY_LH_C4R2 N2
  #define KEY_LH_C3R2 N3
  #define KEY_LH_C2R2 N4
  #define KEY_LH_C1R2 N5
  #define KEY_RH_C1R2 N6
  #define KEY_RH_C2R2 N7
  #define KEY_RH_C3R2 N8
  #define KEY_RH_C4R2 N9
  #define KEY_RH_C5R2 N0
  #define KEY_RH_C6R2 0
  #define KEY_LH_C6R3 0
  #define KEY_LH_C5R3 SQT
  #define KEY_LH_C4R3 COMMA
  #define KEY_LH_C3R3 DOT
  #define KEY_LH_C2R3 P
  #define KEY_LH_C1R3 Y
  #define KEY_RH_C1R3 F
  #define KEY_RH_C2R3 G
  #define KEY_RH_C3R3 C
  #define KEY_RH_C4R3 R
  #define KEY_RH_C5R3 L
  #define KEY_RH_C6R3 SLASH
  #define KEY_LH_C6R4 EQUAL
  #define KEY_LH_C5R4 A
  #define KEY_LH_C4R4 O
  #define KEY_LH_C3R4 E
  #define KEY_LH_C2R4 U
  #define KEY_LH_C1R4 I
  #define KEY_RH_C1R4 D
  #define KEY_RH_C2R4 H
  #define KEY_RH_C3R4 T
  #define KEY_RH_C4R4 N
  #define KEY_RH_C5R4 S
  #define KEY_RH_C6R4 MINUS
  #define KEY_LH_C6R5 0
  #define LAY_LH_C6R5 LAYER_Lower
  #define KEY_LH_C5R5 SEMI
  #define KEY_LH_C4R5 Q
  #define KEY_LH_C3R5 J
  #define KEY_LH_C2R5 K
  #define KEY_LH_C1R5 X
  #define KEY_LH_T1 ESC
  #define LAY_LH_T1 LAYER_Function
  #define KEY_LH_T2 LPAR
  #define KEY_LH_T3 RPAR
  #define KEY_RH_T3 _HOME
  #define KEY_RH_T2 _END
  #define KEY_RH_T1 ENTER
  #define LAY_RH_T1 LAYER_System
  #define KEY_RH_C1R5 B
  #define KEY_RH_C2R5 M
  #define KEY_RH_C3R5 W
  #define KEY_RH_C4R5 V
  #define KEY_RH_C5R5 Z
  #define KEY_RH_C6R5 0
  #define LAY_RH_C6R5 LAYER_Lower
  #define KEY_LH_C6R6 0
  #define KEY_LH_C5R6 GRAVE
  #define KEY_LH_C4R6 LBKT
  #define KEY_LH_C3R6 RBKT
  #define KEY_LH_C2R6 BSLH
  #define LAY_LH_C2R6 LAYER_Emoji
  #define KEY_LH_T4 BACKSPACE
  #define LAY_LH_T4 LAYER_Cursor
  #define KEY_LH_T5 DELETE
  #define LAY_LH_T5 LAYER_Number
  #define KEY_LH_T6 INSERT
  #define LAY_LH_T6 LAYER_Typing
  #define KEY_RH_T6 0
  #define LAY_RH_T6 LAYER_Typing
  #define KEY_RH_T5 TAB
  #define LAY_RH_T5 LAYER_Mouse
  #define KEY_RH_T4 SPACE
  #define LAY_RH_T4 LAYER_Symbol
  #define KEY_RH_C2R6 PAGE_UP
  #define LAY_RH_C2R6 LAYER_World
  #define KEY_RH_C3R6 MOUSE_SCROLL_UP
  #define KEY_RH_C4R6 MOUSE_SCROLL_DOWN
  #define KEY_RH_C5R6 PG_DN
  #define KEY_RH_C6R6 0
#endif
#if defined(LAYER_Colemak) && LAYER_Colemak == 0
  #define KEY_LH_C6R1 0
  #define KEY_LH_C5R1 0
  #define KEY_LH_C4R1 0
  #define KEY_LH_C3R1 0
  #define KEY_LH_C2R1 0
  #define KEY_RH_C2R1 0
  #define KEY_RH_C3R1 0
  #define KEY_RH_C4R1 0
  #define KEY_RH_C5R1 0
  #define KEY_RH_C6R1 0
  #define KEY_LH_C6R2 0
  #define KEY_LH_C5R2 N1
  #define KEY_LH_C4R2 N2
  #define KEY_LH_C3R2 N3
  #define KEY_LH_C2R2 N4
  #define KEY_LH_C1R2 N5
  #define KEY_RH_C1R2 N6
  #define KEY_RH_C2R2 N7
  #define KEY_RH_C3R2 N8
  #define KEY_RH_C4R2 N9
  #define KEY_RH_C5R2 N0
  #define KEY_RH_C6R2 0
  #define KEY_LH_C6R3 0
  #define KEY_LH_C5R3 Q
  #define KEY_LH_C4R3 W
  #define KEY_LH_C3R3 F
  #define KEY_LH_C2R3 P
  #define KEY_LH_C1R3 G
  #define KEY_RH_C1R3 J
  #define KEY_RH_C2R3 L
  #define KEY_RH_C3R3 U
  #define KEY_RH_C4R3 Y
  #define KEY_RH_C5R3 SEMI
  #define KEY_RH_C6R3 MINUS
  #define KEY_LH_C6R4 EQUAL
  #define KEY_LH_C5R4 A
  #define KEY_LH_C4R4 R
  #define KEY_LH_C3R4 S
  #define KEY_LH_C2R4 T
  #define KEY_LH_C1R4 D
  #define KEY_RH_C1R4 H
  #define KEY_RH_C2R4 N
  #define KEY_RH_C3R4 E
  #define KEY_RH_C4R4 I
  #define KEY_RH_C5R4 O
  #define KEY_RH_C6R4 SQT
  #define KEY_LH_C6R5 0
  #define LAY_LH_C6R5 LAYER_Lower
  #define KEY_LH_C5R5 Z
  #define KEY_LH_C4R5 X
  #define KEY_LH_C3R5 C
  #define KEY_LH_C2R5 V
  #define KEY_LH_C1R5 B
  #define KEY_LH_T1 ESC
  #define LAY_LH_T1 LAYER_Function
  #define KEY_LH_T2 LPAR
  #define KEY_LH_T3 RPAR
  #define KEY_RH_T3 _HOME
  #define KEY_RH_T2 _END
  #define KEY_RH_T1 ENTER
  #define LAY_RH_T1 LAYER_System
  #define KEY_RH_C1R5 K
  #define KEY_RH_C2R5 M
  #define KEY_RH_C3R5 COMMA
  #define KEY_RH_C4R5 DOT
  #define KEY_RH_C5R5 FSLH
  #define KEY_RH_C6R5 0
  #define LAY_RH_C6R5 LAYER_Lower
  #define KEY_LH_C6R6 0
  #define KEY_LH_C5R6 GRAVE
  #define KEY_LH_C4R6 LBKT
  #define KEY_LH_C3R6 RBKT
  #define KEY_LH_C2R6 BSLH
  #define LAY_LH_C2R6 LAYER_Emoji
  #define KEY_LH_T4 BACKSPACE
  #define LAY_LH_T4 LAYER_Cursor
  #define KEY_LH_T5 DELETE
  #define LAY_LH_T5 LAYER_Number
  #define KEY_LH_T6 INSERT
  #define LAY_LH_T6 LAYER_Typing
  #define KEY_RH_T6 0
  #define LAY_RH_T6 LAYER_Typing
  #define KEY_RH_T5 TAB
  #define LAY_RH_T5 LAYER_Mouse
  #define KEY_RH_T4 SPACE
  #define LAY_RH_T4 LAYER_Symbol
  #define KEY_RH_C2R6 PAGE_UP
  #define LAY_RH_C2R6 LAYER_World
  #define KEY_RH_C3R6 MOUSE_SCROLL_UP
  #define KEY_RH_C4R6 MOUSE_SCROLL_DOWN
  #define KEY_RH_C5R6 PG_DN
  #define KEY_RH_C6R6 0
#endif
#if defined(LAYER_QWERTY) && LAYER_QWERTY == 0
  #define KEY_LH_C6R1 0
  #define KEY_LH_C5R1 0
  #define KEY_LH_C4R1 0
  #define KEY_LH_C3R1 0
  #define KEY_LH_C2R1 0
  #define KEY_RH_C2R1 0
  #define KEY_RH_C3R1 0
  #define KEY_RH_C4R1 0
  #define KEY_RH_C5R1 0
  #define KEY_RH_C6R1 0
  #define KEY_LH_C6R2 0
  #define KEY_LH_C5R2 N1
  #define KEY_LH_C4R2 N2
  #define KEY_LH_C3R2 N3
  #define KEY_LH_C2R2 N4
  #define KEY_LH_C1R2 N5
  #define KEY_RH_C1R2 N6
  #define KEY_RH_C2R2 N7
  #define KEY_RH_C3R2 N8
  #define KEY_RH_C4R2 N9
  #define KEY_RH_C5R2 N0
  #define KEY_RH_C6R2 0
  #define KEY_LH_C6R3 0
  #define KEY_LH_C5R3 Q
  #define KEY_LH_C4R3 W
  #define KEY_LH_C3R3 E
  #define KEY_LH_C2R3 R
  #define KEY_LH_C1R3 T
  #define KEY_RH_C1R3 Y
  #define KEY_RH_C2R3 U
  #define KEY_RH_C3R3 I
  #define KEY_RH_C4R3 O
  #define KEY_RH_C5R3 P
  #define KEY_RH_C6R3 MINUS
  #define KEY_LH_C6R4 EQUAL
  #define KEY_LH_C5R4 A
  #define KEY_LH_C4R4 S
  #define KEY_LH_C3R4 D
  #define KEY_LH_C2R4 F
  #define KEY_LH_C1R4 G
  #define KEY_RH_C1R4 H
  #define KEY_RH_C2R4 J
  #define KEY_RH_C3R4 K
  #define KEY_RH_C4R4 L
  #define KEY_RH_C5R4 SEMI
  #define KEY_RH_C6R4 SQT
  #define KEY_LH_C6R5 0
  #define LAY_LH_C6R5 LAYER_Lower
  #define KEY_LH_C5R5 Z
  #define KEY_LH_C4R5 X
  #define KEY_LH_C3R5 C
  #define KEY_LH_C2R5 V
  #define KEY_LH_C1R5 B
  #define KEY_LH_T1 ESC
  #define LAY_LH_T1 LAYER_Function
  #define KEY_LH_T2 LPAR
  #define KEY_LH_T3 RPAR
  #define KEY_RH_T3 _HOME
  #define KEY_RH_T2 _END
  #define KEY_RH_T1 ENTER
  #define LAY_RH_T1 LAYER_System
  #define KEY_RH_C1R5 N
  #define KEY_RH_C2R5 M
  #define KEY_RH_C3R5 COMMA
  #define KEY_RH_C4R5 DOT
  #define KEY_RH_C5R5 FSLH
  #define KEY_RH_C6R5 0
  #define LAY_RH_C6R5 LAYER_Lower
  #define KEY_LH_C6R6 0
  #define KEY_LH_C5R6 GRAVE
  #define KEY_LH_C4R6 LBKT
  #define KEY_LH_C3R6 RBKT
  #define KEY_LH_C2R6 BSLH
  #define LAY_LH_C2R6 LAYER_Emoji
  #define KEY_LH_T4 BACKSPACE
  #define LAY_LH_T4 LAYER_Cursor
  #define KEY_LH_T5 DELETE
  #define LAY_LH_T5 LAYER_Number
  #define KEY_LH_T6 INSERT
  #define LAY_LH_T6 LAYER_Typing
  #define KEY_RH_T6 0
  #define LAY_RH_T6 LAYER_Typing
  #define KEY_RH_T5 TAB
  #define LAY_RH_T5 LAYER_Mouse
  #define KEY_RH_T4 SPACE
  #define LAY_RH_T4 LAYER_Symbol
  #define KEY_RH_C2R6 PAGE_UP
  #define LAY_RH_C2R6 LAYER_World
  #define KEY_RH_C3R6 MOUSE_SCROLL_UP
  #define KEY_RH_C4R6 MOUSE_SCROLL_DOWN
  #define KEY_RH_C5R6 PG_DN
  #define KEY_RH_C6R6 0
#endif
#if defined(LAYER_ColemakDH) && LAYER_ColemakDH == 0
  #define KEY_LH_C6R1 0
  #define KEY_LH_C5R1 0
  #define KEY_LH_C4R1 0
  #define KEY_LH_C3R1 0
  #define KEY_LH_C2R1 0
  #define KEY_RH_C2R1 0
  #define KEY_RH_C3R1 0
  #define KEY_RH_C4R1 0
  #define KEY_RH_C5R1 0
  #define KEY_RH_C6R1 0
  #define KEY_LH_C6R2 0
  #define KEY_LH_C5R2 N1
  #define KEY_LH_C4R2 N2
  #define KEY_LH_C3R2 N3
  #define KEY_LH_C2R2 N4
  #define KEY_LH_C1R2 N5
  #define KEY_RH_C1R2 N6
  #define KEY_RH_C2R2 N7
  #define KEY_RH_C3R2 N8
  #define KEY_RH_C4R2 N9
  #define KEY_RH_C5R2 N0
  #define KEY_RH_C6R2 0
  #define KEY_LH_C6R3 0
  #define KEY_LH_C5R3 Q
  #define KEY_LH_C4R3 W
  #define KEY_LH_C3R3 F
  #define KEY_LH_C2R3 P
  #define KEY_LH_C1R3 B
  #define KEY_RH_C1R3 J
  #define KEY_RH_C2R3 L
  #define KEY_RH_C3R3 U
  #define KEY_RH_C4R3 Y
  #define KEY_RH_C5R3 SEMI
  #define KEY_RH_C6R3 MINUS
  #define KEY_LH_C6R4 EQUAL
  #define KEY_LH_C5R4 A
  #define KEY_LH_C4R4 R
  #define KEY_LH_C3R4 S
  #define KEY_LH_C2R4 T
  #define KEY_LH_C1R4 G
  #define KEY_RH_C1R4 M
  #define KEY_RH_C2R4 N
  #define KEY_RH_C3R4 E
  #define KEY_RH_C4R4 I
  #define KEY_RH_C5R4 O
  #define KEY_RH_C6R4 SQT
  #define KEY_LH_C6R5 0
  #define LAY_LH_C6R5 LAYER_Lower
  #define KEY_LH_C5R5 Z
  #define KEY_LH_C4R5 X
  #define KEY_LH_C3R5 C
  #define KEY_LH_C2R5 D
  #define KEY_LH_C1R5 V
  #define KEY_LH_T1 ESC
  #define LAY_LH_T1 LAYER_Function
  #define KEY_LH_T2 LPAR
  #define KEY_LH_T3 RPAR
  #define KEY_RH_T3 _HOME
  #define KEY_RH_T2 _END
  #define KEY_RH_T1 ENTER
  #define LAY_RH_T1 LAYER_System
  #define KEY_RH_C1R5 K
  #define KEY_RH_C2R5 H
  #define KEY_RH_C3R5 COMMA
  #define KEY_RH_C4R5 DOT
  #define KEY_RH_C5R5 FSLH
  #define KEY_RH_C6R5 0
  #define LAY_RH_C6R5 LAYER_Lower
  #define KEY_LH_C6R6 0
  #define KEY_LH_C5R6 GRAVE
  #define KEY_LH_C4R6 LBKT
  #define KEY_LH_C3R6 RBKT
  #define KEY_LH_C2R6 BSLH
  #define LAY_LH_C2R6 LAYER_Emoji
  #define KEY_LH_T4 BACKSPACE
  #define LAY_LH_T4 LAYER_Cursor
  #define KEY_LH_T5 DELETE
  #define LAY_LH_T5 LAYER_Number
  #define KEY_LH_T6 INSERT
  #define LAY_LH_T6 LAYER_Typing
  #define KEY_RH_T6 0
  #define LAY_RH_T6 LAYER_Typing
  #define KEY_RH_T5 TAB
  #define LAY_RH_T5 LAYER_Mouse
  #define KEY_RH_T4 SPACE
  #define LAY_RH_T4 LAYER_Symbol
  #define KEY_RH_C2R6 PAGE_UP
  #define LAY_RH_C2R6 LAYER_World
  #define KEY_RH_C3R6 MOUSE_SCROLL_UP
  #define KEY_RH_C4R6 MOUSE_SCROLL_DOWN
  #define KEY_RH_C5R6 PG_DN
  #define KEY_RH_C6R6 0
#endif

combos {
  compatible = "zmk,combos";

  //
  // COMBO_FIRING_DECAY defines how much time you have left (milliseconds)
  // after pressing the first key in a ZMK combo to finish the whole chord.
  //
  #ifndef COMBO_FIRING_DECAY
  #define COMBO_FIRING_DECAY 50
  #endif

  // T2+T3

  combo_sticky_globe_left {
    timeout-ms = <COMBO_FIRING_DECAY>;
    key-positions = <POS_LH_T2 POS_LH_T3>;
    bindings = <&sk _GLOBE>;
    layers = <0 1 2 3 4 5 6>;
  };

  combo_sticky_globe_right {
    timeout-ms = <COMBO_FIRING_DECAY>;
    key-positions = <POS_RH_T2 POS_RH_T3>;
    bindings = <&sk _GLOBE>;
    layers = <0 1 2 3 4 5 6>;
  };

  // T1+T2

  combo_sticky_ralt_left {
    timeout-ms = <COMBO_FIRING_DECAY>;
    key-positions = <POS_LH_T1 POS_LH_T2>;
    bindings = <&sk RALT>;
    layers = <0 1 2 3 4 5 6>;
  };

  combo_sticky_ralt_right {
    timeout-ms = <COMBO_FIRING_DECAY>;
    key-positions = <POS_RH_T1 POS_RH_T2>;
    bindings = <&sk RALT>;
    layers = <0 1 2 3 4 5 6>;
  };

  // T2+T5
  #if defined(_A_TAB) && defined(LAYER_Cursor)
  combo_alt_tab_switcher_left {
    timeout-ms = <COMBO_FIRING_DECAY>;
    key-positions = <POS_LH_T2 POS_LH_T5>;
    bindings = <&mod_tab_chord _A_TAB LAYER_Cursor>;
    layers = <0 1 2 3 4 5 6>;
  };
  #endif

  combo_hyper_right {
    timeout-ms = <COMBO_FIRING_DECAY>;
    key-positions = <POS_RH_T2 POS_RH_T5>;
    bindings = <&kp LG(LA(LC(LSHFT)))>;
    layers = <0 1 2 3 4 5 6>;
  };

  // T5+T6
  #if defined(_G_TAB) && defined(LAYER_Cursor)
  combo_win_tab_switcher_left {
    timeout-ms = <COMBO_FIRING_DECAY>;
    key-positions = <POS_LH_T5 POS_LH_T6>;
    bindings = <&mod_tab_chord _G_TAB LAYER_Cursor>;
    layers = <0 1 2 3 4 5 6>;
  };
  #endif

  combo_ctrl_shift_right {
    timeout-ms = <COMBO_FIRING_DECAY>;
    key-positions = <POS_RH_T5 POS_RH_T6>;
    bindings = <&kp LC(LSHFT)>;
    layers = <0 1 2 3 4 5 6>;
  };

  // T3+T6

  combo_ctrl_tab_switcher_left {
    timeout-ms = <COMBO_FIRING_DECAY>;
    key-positions = <POS_LH_T3 POS_LH_T6>;
    bindings = <&mod_tab_chord LCTL LAYER_Cursor>;
    layers = <0 1 2 3 4 5 6>;
  };

  combo_meh_right {
    timeout-ms = <COMBO_FIRING_DECAY>;
    key-positions = <POS_RH_T3 POS_RH_T6>;
    bindings = <&kp LA(LC(LSHFT))>;
    layers = <0 1 2 3 4 5 6>;
  };

  // T1+T4

  combo_sticky_shift_left {
    timeout-ms = <COMBO_FIRING_DECAY>;
    key-positions = <POS_LH_T1 POS_LH_T4>;
    bindings = <&sticky_key_modtap LSFT LSFT>;
    layers = <0 1 2 3 4 5 6 7>;
  };

  combo_sticky_shift_right {
    timeout-ms = <COMBO_FIRING_DECAY>;
    key-positions = <POS_RH_T1 POS_RH_T4>;
    bindings = <&sticky_key_modtap RSFT RSFT>;
    layers = <0 1 2 3 4 5 6 7>;
  };

  // T4+T5

  combo_caps_word_left {
    timeout-ms = <COMBO_FIRING_DECAY>;
    key-positions = <POS_LH_T4 POS_LH_T5>;
    bindings = <&caps_word>;
    layers = <0 1 2 3 4 5 6>;
  };

  combo_caps_word_right {
    timeout-ms = <COMBO_FIRING_DECAY>;
    key-positions = <POS_RH_T4 POS_RH_T5>;
    bindings = <&caps_word>;
    layers = <0 1 2 3 4 5 6>;
  };

  // T1+T5

  combo_caps_lock_left {
    timeout-ms = <COMBO_FIRING_DECAY>;
    key-positions = <POS_LH_T1 POS_LH_T5>;
    bindings = <&kp CAPSLOCK>;
    layers = <0 1 2 3 4 5 6>;
  };

  combo_caps_lock_right {
    timeout-ms = <COMBO_FIRING_DECAY>;
    key-positions = <POS_RH_T1 POS_RH_T5>;
    bindings = <&kp CAPSLOCK>;
    layers = <0 1 2 3 4 5 6>;
  };

  // C1R5+C2R6
  #ifdef LAYER_Gaming
  combo_gaming_layer_toggle {
    timeout-ms = <COMBO_FIRING_DECAY>;
    key-positions = <POS_LH_C1R5 POS_LH_C2R6>;
    bindings = <&tog LAYER_Gaming>;
    layers = <0 LAYER_Gaming>;
  };
  #endif
  #ifdef LAYER_Typing
  combo_typing_layer_toggle {
    timeout-ms = <COMBO_FIRING_DECAY>;
    key-positions = <POS_RH_C1R5 POS_RH_C2R6>;
    bindings = <&tog LAYER_Typing>;
    layers = <0 LAYER_Typing>;
  };
  #endif

  // T1+T2+T3

  combo_sticky_base_layer_reset_left {
    timeout-ms = <COMBO_FIRING_DECAY>;
    key-positions = <POS_LH_T1 POS_LH_T2 POS_LH_T3>;
    bindings = <&to 0>;
    layers = <0 1 2 3 4 5 6 7 8 9 10 11 12 13 14 15 16 17 18 19 20 21 22 23 24 25 26 27 28 29 30>;
  };

  combo_sticky_base_layer_reset_right {
    timeout-ms = <COMBO_FIRING_DECAY>;
    key-positions = <POS_RH_T1 POS_RH_T2 POS_RH_T3>;
    bindings = <&to 0>;
    layers = <0 1 2 3 4 5 6 7 8 9 10 11 12 13 14 15 16 17 18 19 20 21 22 23 24 25 26 27 28 29 30>;
  };

};

