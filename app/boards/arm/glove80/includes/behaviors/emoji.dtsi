  // Emoji layer - modern age pictograms
  //
  //////////////////////////////////////////////////////////////////////////

  //
  // EMOJI_GENDER_SIGN_PRESET defines an Emoji gender sign for use as a
  // convenient inward-rolling shortcut on the home row of the layer.
  //
  #ifndef EMOJI_GENDER_SIGN_PRESET
  #define EMOJI_GENDER_SIGN_PRESET 'N' // neutral
  //#define EMOJI_GENDER_SIGN_PRESET 'M' // male
  //#define EMOJI_GENDER_SIGN_PRESET 'F' // female
  #endif

  //
  // EMOJI_SKIN_TONE_PRESET defines an Emoji skin tone for use as a
  // convenient inward-rolling shortcut on the home row of the layer.
  //
  #ifndef EMOJI_SKIN_TONE_PRESET
  #define EMOJI_SKIN_TONE_PRESET 'N' // neutral
  //#define EMOJI_SKIN_TONE_PRESET 'L' // light_skin_tone
  //#define EMOJI_SKIN_TONE_PRESET 'l' // medium_light_skin_tone
  //#define EMOJI_SKIN_TONE_PRESET 'M' // medium_skin_tone
  //#define EMOJI_SKIN_TONE_PRESET 'd' // medium_dark_skin_tone
  //#define EMOJI_SKIN_TONE_PRESET 'D' // dark_skin_tone
  #endif

  //
  // EMOJI_HAIR_STYLE_PRESET defines an Emoji hair style for use as a
  // convenient inward-rolling shortcut on the home row of the layer.
  //
  #ifndef EMOJI_HAIR_STYLE_PRESET
  #define EMOJI_HAIR_STYLE_PRESET 'N' // neutral
  //#define EMOJI_HAIR_STYLE_PRESET 'B' // bald
  //#define EMOJI_HAIR_STYLE_PRESET 'R' // red_hair
  //#define EMOJI_HAIR_STYLE_PRESET 'C' // curly_hair
  //#define EMOJI_HAIR_STYLE_PRESET 'W' // white_hair
  #endif

  //
  // NOTE: edit the emoji.yaml file and run `rake` to generate this:
  //

  //
  // codepoints
  //
  UNICODE(emoji_zwj_macro, /* ‍ */
    #if OPERATING_SYSTEM == 'L'
      UNICODE_SEQ_LINUX(&kp _N2 &kp _N0 &kp _N0 &kp _ND)
    #elif OPERATING_SYSTEM == 'M'
      UNICODE_SEQ_MACOS(&kp _N2 &kp _N0 &kp _N0 &kp _ND)
    #elif OPERATING_SYSTEM == 'W'
      UNICODE_SEQ_WINDOWS(&kp _N0 &kp _N2 &kp _N0 &kp _N0 &kp _ND)
    #endif
  )
  emoji_zwj: emoji_zwj {
    compatible = "zmk,behavior-mod-morph";
    #binding-cells = <0>;
    bindings = <&emoji_zwj_macro>, <&emoji_zwj_macro>;
    mods = <(~(
#ifdef WORLD_USE_COMPOSE_FOR_emoji_zwj
  COMPOSE_MORPH_MODS
#else
  UNICODE_MORPH_MODS
#endif
))>;
  };
  UNICODE(emoji_male_sign_macro, /* ♂️ */
    #if OPERATING_SYSTEM == 'L'
      UNICODE_SEQ_LINUX(&kp _N2 &kp _N6 &kp _N4 &kp _N2), <&macro_wait_time UNICODE_SEQ_DELAY>, UNICODE_SEQ_LINUX(&kp _NF &kp _NE &kp _N0 &kp _NF)
    #elif OPERATING_SYSTEM == 'M'
      UNICODE_SEQ_MACOS(&kp _N2 &kp _N6 &kp _N4 &kp _N2), <&macro_wait_time UNICODE_SEQ_DELAY>, UNICODE_SEQ_MACOS(&kp _NF &kp _NE &kp _N0 &kp _NF)
    #elif OPERATING_SYSTEM == 'W'
      UNICODE_SEQ_WINDOWS(&kp _N0 &kp _N2 &kp _N6 &kp _N4 &kp _N2), <&macro_wait_time UNICODE_SEQ_DELAY>, UNICODE_SEQ_WINDOWS(&kp _N0 &kp _NF &kp _NE &kp _N0 &kp _NF)
    #endif
  )
  emoji_male_sign: emoji_male_sign {
    compatible = "zmk,behavior-mod-morph";
    #binding-cells = <0>;
    bindings = <&emoji_male_sign_macro>, <&emoji_male_sign_macro>;
    mods = <(~(
#ifdef WORLD_USE_COMPOSE_FOR_emoji_male_sign
  COMPOSE_MORPH_MODS
#else
  UNICODE_MORPH_MODS
#endif
))>;
  };
  UNICODE(emoji_female_sign_macro, /* ♀️ */
    #if OPERATING_SYSTEM == 'L'
      UNICODE_SEQ_LINUX(&kp _N2 &kp _N6 &kp _N4 &kp _N0), <&macro_wait_time UNICODE_SEQ_DELAY>, UNICODE_SEQ_LINUX(&kp _NF &kp _NE &kp _N0 &kp _NF)
    #elif OPERATING_SYSTEM == 'M'
      UNICODE_SEQ_MACOS(&kp _N2 &kp _N6 &kp _N4 &kp _N0), <&macro_wait_time UNICODE_SEQ_DELAY>, UNICODE_SEQ_MACOS(&kp _NF &kp _NE &kp _N0 &kp _NF)
    #elif OPERATING_SYSTEM == 'W'
      UNICODE_SEQ_WINDOWS(&kp _N0 &kp _N2 &kp _N6 &kp _N4 &kp _N0), <&macro_wait_time UNICODE_SEQ_DELAY>, UNICODE_SEQ_WINDOWS(&kp _N0 &kp _NF &kp _NE &kp _N0 &kp _NF)
    #endif
  )
  emoji_female_sign: emoji_female_sign {
    compatible = "zmk,behavior-mod-morph";
    #binding-cells = <0>;
    bindings = <&emoji_female_sign_macro>, <&emoji_female_sign_macro>;
    mods = <(~(
#ifdef WORLD_USE_COMPOSE_FOR_emoji_female_sign
  COMPOSE_MORPH_MODS
#else
  UNICODE_MORPH_MODS
#endif
))>;
  };
  UNICODE(emoji_right_arrow_macro, /* ➡️ */
    #if OPERATING_SYSTEM == 'L'
      UNICODE_SEQ_LINUX(&kp _N2 &kp _N7 &kp _NA &kp _N1), <&macro_wait_time UNICODE_SEQ_DELAY>, UNICODE_SEQ_LINUX(&kp _NF &kp _NE &kp _N0 &kp _NF)
    #elif OPERATING_SYSTEM == 'M'
      UNICODE_SEQ_MACOS(&kp _N2 &kp _N7 &kp _NA &kp _N1), <&macro_wait_time UNICODE_SEQ_DELAY>, UNICODE_SEQ_MACOS(&kp _NF &kp _NE &kp _N0 &kp _NF)
    #elif OPERATING_SYSTEM == 'W'
      UNICODE_SEQ_WINDOWS(&kp _N0 &kp _N2 &kp _N7 &kp _NA &kp _N1), <&macro_wait_time UNICODE_SEQ_DELAY>, UNICODE_SEQ_WINDOWS(&kp _N0 &kp _NF &kp _NE &kp _N0 &kp _NF)
    #endif
  )
  emoji_right_arrow: emoji_right_arrow {
    compatible = "zmk,behavior-mod-morph";
    #binding-cells = <0>;
    bindings = <&emoji_right_arrow_macro>, <&emoji_right_arrow_macro>;
    mods = <(~(
#ifdef WORLD_USE_COMPOSE_FOR_emoji_right_arrow
  COMPOSE_MORPH_MODS
#else
  UNICODE_MORPH_MODS
#endif
))>;
  };
  UNICODE(emoji_left_arrow_macro, /* ⬅️ */
    #if OPERATING_SYSTEM == 'L'
      UNICODE_SEQ_LINUX(&kp _N2 &kp _NB &kp _N0 &kp _N5), <&macro_wait_time UNICODE_SEQ_DELAY>, UNICODE_SEQ_LINUX(&kp _NF &kp _NE &kp _N0 &kp _NF)
    #elif OPERATING_SYSTEM == 'M'
      UNICODE_SEQ_MACOS(&kp _N2 &kp _NB &kp _N0 &kp _N5), <&macro_wait_time UNICODE_SEQ_DELAY>, UNICODE_SEQ_MACOS(&kp _NF &kp _NE &kp _N0 &kp _NF)
    #elif OPERATING_SYSTEM == 'W'
      UNICODE_SEQ_WINDOWS(&kp _N0 &kp _N2 &kp _NB &kp _N0 &kp _N5), <&macro_wait_time UNICODE_SEQ_DELAY>, UNICODE_SEQ_WINDOWS(&kp _N0 &kp _NF &kp _NE &kp _N0 &kp _NF)
    #endif
  )
  emoji_left_arrow: emoji_left_arrow {
    compatible = "zmk,behavior-mod-morph";
    #binding-cells = <0>;
    bindings = <&emoji_left_arrow_macro>, <&emoji_left_arrow_macro>;
    mods = <(~(
#ifdef WORLD_USE_COMPOSE_FOR_emoji_left_arrow
  COMPOSE_MORPH_MODS
#else
  UNICODE_MORPH_MODS
#endif
))>;
  };
  UNICODE(emoji_rainbow_macro, /* 🌈 */
    #if OPERATING_SYSTEM == 'L'
      UNICODE_SEQ_LINUX(&kp _N1 &kp _NF &kp _N3 &kp _N0 &kp _N8)
    #elif OPERATING_SYSTEM == 'M'
      UNICODE_SEQ_MACOS(&kp _ND &kp _N8 &kp _N3 &kp _NC &kp _ND &kp _NF &kp _N0 &kp _N8)
    #elif OPERATING_SYSTEM == 'W'
      UNICODE_SEQ_WINDOWS(&kp _N0 &kp _N1 &kp _NF &kp _N3 &kp _N0 &kp _N8)
    #endif
  )
  emoji_rainbow: emoji_rainbow {
    compatible = "zmk,behavior-mod-morph";
    #binding-cells = <0>;
    bindings = <&emoji_rainbow_macro>, <&emoji_rainbow_macro>;
    mods = <(~(
#ifdef WORLD_USE_COMPOSE_FOR_emoji_rainbow
  COMPOSE_MORPH_MODS
#else
  UNICODE_MORPH_MODS
#endif
))>;
  };
  UNICODE(emoji_cloudy_macro, /* ️☁️ */
    #if OPERATING_SYSTEM == 'L'
      UNICODE_SEQ_LINUX(&kp _NF &kp _NE &kp _N0 &kp _NF), <&macro_wait_time UNICODE_SEQ_DELAY>, UNICODE_SEQ_LINUX(&kp _N2 &kp _N6 &kp _N0 &kp _N1), UNICODE_SEQ_LINUX(&kp _NF &kp _NE &kp _N0 &kp _NF)
    #elif OPERATING_SYSTEM == 'M'
      UNICODE_SEQ_MACOS(&kp _NF &kp _NE &kp _N0 &kp _NF), <&macro_wait_time UNICODE_SEQ_DELAY>, UNICODE_SEQ_MACOS(&kp _N2 &kp _N6 &kp _N0 &kp _N1), UNICODE_SEQ_MACOS(&kp _NF &kp _NE &kp _N0 &kp _NF)
    #elif OPERATING_SYSTEM == 'W'
      UNICODE_SEQ_WINDOWS(&kp _N0 &kp _NF &kp _NE &kp _N0 &kp _NF), <&macro_wait_time UNICODE_SEQ_DELAY>, UNICODE_SEQ_WINDOWS(&kp _N0 &kp _N2 &kp _N6 &kp _N0 &kp _N1), UNICODE_SEQ_WINDOWS(&kp _N0 &kp _NF &kp _NE &kp _N0 &kp _NF)
    #endif
  )
  emoji_cloudy: emoji_cloudy {
    compatible = "zmk,behavior-mod-morph";
    #binding-cells = <0>;
    bindings = <&emoji_cloudy_macro>, <&emoji_cloudy_macro>;
    mods = <(~(
#ifdef WORLD_USE_COMPOSE_FOR_emoji_cloudy
  COMPOSE_MORPH_MODS
#else
  UNICODE_MORPH_MODS
#endif
))>;
  };
  UNICODE(emoji_mostly_cloudy_macro, /* 🌥 */
    #if OPERATING_SYSTEM == 'L'
      UNICODE_SEQ_LINUX(&kp _N1 &kp _NF &kp _N3 &kp _N2 &kp _N5)
    #elif OPERATING_SYSTEM == 'M'
      UNICODE_SEQ_MACOS(&kp _ND &kp _N8 &kp _N3 &kp _NC &kp _ND &kp _NF &kp _N2 &kp _N5)
    #elif OPERATING_SYSTEM == 'W'
      UNICODE_SEQ_WINDOWS(&kp _N0 &kp _N1 &kp _NF &kp _N3 &kp _N2 &kp _N5)
    #endif
  )
  emoji_mostly_cloudy: emoji_mostly_cloudy {
    compatible = "zmk,behavior-mod-morph";
    #binding-cells = <0>;
    bindings = <&emoji_mostly_cloudy_macro>, <&emoji_mostly_cloudy_macro>;
    mods = <(~(
#ifdef WORLD_USE_COMPOSE_FOR_emoji_mostly_cloudy
  COMPOSE_MORPH_MODS
#else
  UNICODE_MORPH_MODS
#endif
))>;
  };
  UNICODE(emoji_partly_cloudy_macro, /* ⛅ */
    #if OPERATING_SYSTEM == 'L'
      UNICODE_SEQ_LINUX(&kp _N2 &kp _N6 &kp _NC &kp _N5)
    #elif OPERATING_SYSTEM == 'M'
      UNICODE_SEQ_MACOS(&kp _N2 &kp _N6 &kp _NC &kp _N5)
    #elif OPERATING_SYSTEM == 'W'
      UNICODE_SEQ_WINDOWS(&kp _N0 &kp _N2 &kp _N6 &kp _NC &kp _N5)
    #endif
  )
  emoji_partly_cloudy: emoji_partly_cloudy {
    compatible = "zmk,behavior-mod-morph";
    #binding-cells = <0>;
    bindings = <&emoji_partly_cloudy_macro>, <&emoji_partly_cloudy_macro>;
    mods = <(~(
#ifdef WORLD_USE_COMPOSE_FOR_emoji_partly_cloudy
  COMPOSE_MORPH_MODS
#else
  UNICODE_MORPH_MODS
#endif
))>;
  };
  UNICODE(emoji_mostly_sunny_macro, /* ️🌤️ */
    #if OPERATING_SYSTEM == 'L'
      UNICODE_SEQ_LINUX(&kp _NF &kp _NE &kp _N0 &kp _NF), <&macro_wait_time UNICODE_SEQ_DELAY>, UNICODE_SEQ_LINUX(&kp _N1 &kp _NF &kp _N3 &kp _N2 &kp _N4), UNICODE_SEQ_LINUX(&kp _NF &kp _NE &kp _N0 &kp _NF)
    #elif OPERATING_SYSTEM == 'M'
      UNICODE_SEQ_MACOS(&kp _NF &kp _NE &kp _N0 &kp _NF), <&macro_wait_time UNICODE_SEQ_DELAY>, UNICODE_SEQ_MACOS(&kp _ND &kp _N8 &kp _N3 &kp _NC &kp _ND &kp _NF &kp _N2 &kp _N4), UNICODE_SEQ_MACOS(&kp _NF &kp _NE &kp _N0 &kp _NF)
    #elif OPERATING_SYSTEM == 'W'
      UNICODE_SEQ_WINDOWS(&kp _N0 &kp _NF &kp _NE &kp _N0 &kp _NF), <&macro_wait_time UNICODE_SEQ_DELAY>, UNICODE_SEQ_WINDOWS(&kp _N0 &kp _N1 &kp _NF &kp _N3 &kp _N2 &kp _N4), UNICODE_SEQ_WINDOWS(&kp _N0 &kp _NF &kp _NE &kp _N0 &kp _NF)
    #endif
  )
  emoji_mostly_sunny: emoji_mostly_sunny {
    compatible = "zmk,behavior-mod-morph";
    #binding-cells = <0>;
    bindings = <&emoji_mostly_sunny_macro>, <&emoji_mostly_sunny_macro>;
    mods = <(~(
#ifdef WORLD_USE_COMPOSE_FOR_emoji_mostly_sunny
  COMPOSE_MORPH_MODS
#else
  UNICODE_MORPH_MODS
#endif
))>;
  };
  UNICODE(emoji_sunny_macro, /* ☀️ */
    #if OPERATING_SYSTEM == 'L'
      UNICODE_SEQ_LINUX(&kp _N2 &kp _N6 &kp _N0 &kp _N0), <&macro_wait_time UNICODE_SEQ_DELAY>, UNICODE_SEQ_LINUX(&kp _NF &kp _NE &kp _N0 &kp _NF)
    #elif OPERATING_SYSTEM == 'M'
      UNICODE_SEQ_MACOS(&kp _N2 &kp _N6 &kp _N0 &kp _N0), <&macro_wait_time UNICODE_SEQ_DELAY>, UNICODE_SEQ_MACOS(&kp _NF &kp _NE &kp _N0 &kp _NF)
    #elif OPERATING_SYSTEM == 'W'
      UNICODE_SEQ_WINDOWS(&kp _N0 &kp _N2 &kp _N6 &kp _N0 &kp _N0), <&macro_wait_time UNICODE_SEQ_DELAY>, UNICODE_SEQ_WINDOWS(&kp _N0 &kp _NF &kp _NE &kp _N0 &kp _NF)
    #endif
  )
  emoji_sunny: emoji_sunny {
    compatible = "zmk,behavior-mod-morph";
    #binding-cells = <0>;
    bindings = <&emoji_sunny_macro>, <&emoji_sunny_macro>;
    mods = <(~(
#ifdef WORLD_USE_COMPOSE_FOR_emoji_sunny
  COMPOSE_MORPH_MODS
#else
  UNICODE_MORPH_MODS
#endif
))>;
  };
  UNICODE(emoji_sunrise_macro, /* 🌅 */
    #if OPERATING_SYSTEM == 'L'
      UNICODE_SEQ_LINUX(&kp _N1 &kp _NF &kp _N3 &kp _N0 &kp _N5)
    #elif OPERATING_SYSTEM == 'M'
      UNICODE_SEQ_MACOS(&kp _ND &kp _N8 &kp _N3 &kp _NC &kp _ND &kp _NF &kp _N0 &kp _N5)
    #elif OPERATING_SYSTEM == 'W'
      UNICODE_SEQ_WINDOWS(&kp _N0 &kp _N1 &kp _NF &kp _N3 &kp _N0 &kp _N5)
    #endif
  )
  emoji_sunrise: emoji_sunrise {
    compatible = "zmk,behavior-mod-morph";
    #binding-cells = <0>;
    bindings = <&emoji_sunrise_macro>, <&emoji_sunrise_macro>;
    mods = <(~(
#ifdef WORLD_USE_COMPOSE_FOR_emoji_sunrise
  COMPOSE_MORPH_MODS
#else
  UNICODE_MORPH_MODS
#endif
))>;
  };
  UNICODE(emoji_sunrise_mountains_macro, /* 🌄 */
    #if OPERATING_SYSTEM == 'L'
      UNICODE_SEQ_LINUX(&kp _N1 &kp _NF &kp _N3 &kp _N0 &kp _N4)
    #elif OPERATING_SYSTEM == 'M'
      UNICODE_SEQ_MACOS(&kp _ND &kp _N8 &kp _N3 &kp _NC &kp _ND &kp _NF &kp _N0 &kp _N4)
    #elif OPERATING_SYSTEM == 'W'
      UNICODE_SEQ_WINDOWS(&kp _N0 &kp _N1 &kp _NF &kp _N3 &kp _N0 &kp _N4)
    #endif
  )
  emoji_sunrise_mountains: emoji_sunrise_mountains {
    compatible = "zmk,behavior-mod-morph";
    #binding-cells = <0>;
    bindings = <&emoji_sunrise_mountains_macro>, <&emoji_sunrise_mountains_macro>;
    mods = <(~(
#ifdef WORLD_USE_COMPOSE_FOR_emoji_sunrise_mountains
  COMPOSE_MORPH_MODS
#else
  UNICODE_MORPH_MODS
#endif
))>;
  };
  UNICODE(emoji_cityscape_macro, /* ️🏙️ */
    #if OPERATING_SYSTEM == 'L'
      UNICODE_SEQ_LINUX(&kp _NF &kp _NE &kp _N0 &kp _NF), <&macro_wait_time UNICODE_SEQ_DELAY>, UNICODE_SEQ_LINUX(&kp _N1 &kp _NF &kp _N3 &kp _ND &kp _N9), UNICODE_SEQ_LINUX(&kp _NF &kp _NE &kp _N0 &kp _NF)
    #elif OPERATING_SYSTEM == 'M'
      UNICODE_SEQ_MACOS(&kp _NF &kp _NE &kp _N0 &kp _NF), <&macro_wait_time UNICODE_SEQ_DELAY>, UNICODE_SEQ_MACOS(&kp _ND &kp _N8 &kp _N3 &kp _NC &kp _ND &kp _NF &kp _ND &kp _N9), UNICODE_SEQ_MACOS(&kp _NF &kp _NE &kp _N0 &kp _NF)
    #elif OPERATING_SYSTEM == 'W'
      UNICODE_SEQ_WINDOWS(&kp _N0 &kp _NF &kp _NE &kp _N0 &kp _NF), <&macro_wait_time UNICODE_SEQ_DELAY>, UNICODE_SEQ_WINDOWS(&kp _N0 &kp _N1 &kp _NF &kp _N3 &kp _ND &kp _N9), UNICODE_SEQ_WINDOWS(&kp _N0 &kp _NF &kp _NE &kp _N0 &kp _NF)
    #endif
  )
  emoji_cityscape: emoji_cityscape {
    compatible = "zmk,behavior-mod-morph";
    #binding-cells = <0>;
    bindings = <&emoji_cityscape_macro>, <&emoji_cityscape_macro>;
    mods = <(~(
#ifdef WORLD_USE_COMPOSE_FOR_emoji_cityscape
  COMPOSE_MORPH_MODS
#else
  UNICODE_MORPH_MODS
#endif
))>;
  };
  UNICODE(emoji_cityscape_dusk_macro, /* ️🌇 */
    #if OPERATING_SYSTEM == 'L'
      UNICODE_SEQ_LINUX(&kp _NF &kp _NE &kp _N0 &kp _NF), <&macro_wait_time UNICODE_SEQ_DELAY>, UNICODE_SEQ_LINUX(&kp _N1 &kp _NF &kp _N3 &kp _N0 &kp _N7)
    #elif OPERATING_SYSTEM == 'M'
      UNICODE_SEQ_MACOS(&kp _NF &kp _NE &kp _N0 &kp _NF), <&macro_wait_time UNICODE_SEQ_DELAY>, UNICODE_SEQ_MACOS(&kp _ND &kp _N8 &kp _N3 &kp _NC &kp _ND &kp _NF &kp _N0 &kp _N7)
    #elif OPERATING_SYSTEM == 'W'
      UNICODE_SEQ_WINDOWS(&kp _N0 &kp _NF &kp _NE &kp _N0 &kp _NF), <&macro_wait_time UNICODE_SEQ_DELAY>, UNICODE_SEQ_WINDOWS(&kp _N0 &kp _N1 &kp _NF &kp _N3 &kp _N0 &kp _N7)
    #endif
  )
  emoji_cityscape_dusk: emoji_cityscape_dusk {
    compatible = "zmk,behavior-mod-morph";
    #binding-cells = <0>;
    bindings = <&emoji_cityscape_dusk_macro>, <&emoji_cityscape_dusk_macro>;
    mods = <(~(
#ifdef WORLD_USE_COMPOSE_FOR_emoji_cityscape_dusk
  COMPOSE_MORPH_MODS
#else
  UNICODE_MORPH_MODS
#endif
))>;
  };
  UNICODE(emoji_cityscape_night_macro, /* 🌃 */
    #if OPERATING_SYSTEM == 'L'
      UNICODE_SEQ_LINUX(&kp _N1 &kp _NF &kp _N3 &kp _N0 &kp _N3)
    #elif OPERATING_SYSTEM == 'M'
      UNICODE_SEQ_MACOS(&kp _ND &kp _N8 &kp _N3 &kp _NC &kp _ND &kp _NF &kp _N0 &kp _N3)
    #elif OPERATING_SYSTEM == 'W'
      UNICODE_SEQ_WINDOWS(&kp _N0 &kp _N1 &kp _NF &kp _N3 &kp _N0 &kp _N3)
    #endif
  )
  emoji_cityscape_night: emoji_cityscape_night {
    compatible = "zmk,behavior-mod-morph";
    #binding-cells = <0>;
    bindings = <&emoji_cityscape_night_macro>, <&emoji_cityscape_night_macro>;
    mods = <(~(
#ifdef WORLD_USE_COMPOSE_FOR_emoji_cityscape_night
  COMPOSE_MORPH_MODS
#else
  UNICODE_MORPH_MODS
#endif
))>;
  };
  UNICODE(emoji_light_skin_tone_macro, /* 🏻 */
    #if OPERATING_SYSTEM == 'L'
      UNICODE_SEQ_LINUX(&kp _N1 &kp _NF &kp _N3 &kp _NF &kp _NB)
    #elif OPERATING_SYSTEM == 'M'
      UNICODE_SEQ_MACOS(&kp _ND &kp _N8 &kp _N3 &kp _NC &kp _ND &kp _NF &kp _NF &kp _NB)
    #elif OPERATING_SYSTEM == 'W'
      UNICODE_SEQ_WINDOWS(&kp _N0 &kp _N1 &kp _NF &kp _N3 &kp _NF &kp _NB)
    #endif
  )
  emoji_light_skin_tone: emoji_light_skin_tone {
    compatible = "zmk,behavior-mod-morph";
    #binding-cells = <0>;
    bindings = <&emoji_light_skin_tone_macro>, <&emoji_light_skin_tone_macro>;
    mods = <(~(
#ifdef WORLD_USE_COMPOSE_FOR_emoji_light_skin_tone
  COMPOSE_MORPH_MODS
#else
  UNICODE_MORPH_MODS
#endif
))>;
  };
  UNICODE(emoji_medium_light_skin_tone_macro, /* 🏼 */
    #if OPERATING_SYSTEM == 'L'
      UNICODE_SEQ_LINUX(&kp _N1 &kp _NF &kp _N3 &kp _NF &kp _NC)
    #elif OPERATING_SYSTEM == 'M'
      UNICODE_SEQ_MACOS(&kp _ND &kp _N8 &kp _N3 &kp _NC &kp _ND &kp _NF &kp _NF &kp _NC)
    #elif OPERATING_SYSTEM == 'W'
      UNICODE_SEQ_WINDOWS(&kp _N0 &kp _N1 &kp _NF &kp _N3 &kp _NF &kp _NC)
    #endif
  )
  emoji_medium_light_skin_tone: emoji_medium_light_skin_tone {
    compatible = "zmk,behavior-mod-morph";
    #binding-cells = <0>;
    bindings = <&emoji_medium_light_skin_tone_macro>, <&emoji_medium_light_skin_tone_macro>;
    mods = <(~(
#ifdef WORLD_USE_COMPOSE_FOR_emoji_medium_light_skin_tone
  COMPOSE_MORPH_MODS
#else
  UNICODE_MORPH_MODS
#endif
))>;
  };
  UNICODE(emoji_medium_skin_tone_macro, /* 🏽 */
    #if OPERATING_SYSTEM == 'L'
      UNICODE_SEQ_LINUX(&kp _N1 &kp _NF &kp _N3 &kp _NF &kp _ND)
    #elif OPERATING_SYSTEM == 'M'
      UNICODE_SEQ_MACOS(&kp _ND &kp _N8 &kp _N3 &kp _NC &kp _ND &kp _NF &kp _NF &kp _ND)
    #elif OPERATING_SYSTEM == 'W'
      UNICODE_SEQ_WINDOWS(&kp _N0 &kp _N1 &kp _NF &kp _N3 &kp _NF &kp _ND)
    #endif
  )
  emoji_medium_skin_tone: emoji_medium_skin_tone {
    compatible = "zmk,behavior-mod-morph";
    #binding-cells = <0>;
    bindings = <&emoji_medium_skin_tone_macro>, <&emoji_medium_skin_tone_macro>;
    mods = <(~(
#ifdef WORLD_USE_COMPOSE_FOR_emoji_medium_skin_tone
  COMPOSE_MORPH_MODS
#else
  UNICODE_MORPH_MODS
#endif
))>;
  };
  UNICODE(emoji_medium_dark_skin_tone_macro, /* 🏾 */
    #if OPERATING_SYSTEM == 'L'
      UNICODE_SEQ_LINUX(&kp _N1 &kp _NF &kp _N3 &kp _NF &kp _NE)
    #elif OPERATING_SYSTEM == 'M'
      UNICODE_SEQ_MACOS(&kp _ND &kp _N8 &kp _N3 &kp _NC &kp _ND &kp _NF &kp _NF &kp _NE)
    #elif OPERATING_SYSTEM == 'W'
      UNICODE_SEQ_WINDOWS(&kp _N0 &kp _N1 &kp _NF &kp _N3 &kp _NF &kp _NE)
    #endif
  )
  emoji_medium_dark_skin_tone: emoji_medium_dark_skin_tone {
    compatible = "zmk,behavior-mod-morph";
    #binding-cells = <0>;
    bindings = <&emoji_medium_dark_skin_tone_macro>, <&emoji_medium_dark_skin_tone_macro>;
    mods = <(~(
#ifdef WORLD_USE_COMPOSE_FOR_emoji_medium_dark_skin_tone
  COMPOSE_MORPH_MODS
#else
  UNICODE_MORPH_MODS
#endif
))>;
  };
  UNICODE(emoji_dark_skin_tone_macro, /* 🏿 */
    #if OPERATING_SYSTEM == 'L'
      UNICODE_SEQ_LINUX(&kp _N1 &kp _NF &kp _N3 &kp _NF &kp _NF)
    #elif OPERATING_SYSTEM == 'M'
      UNICODE_SEQ_MACOS(&kp _ND &kp _N8 &kp _N3 &kp _NC &kp _ND &kp _NF &kp _NF &kp _NF)
    #elif OPERATING_SYSTEM == 'W'
      UNICODE_SEQ_WINDOWS(&kp _N0 &kp _N1 &kp _NF &kp _N3 &kp _NF &kp _NF)
    #endif
  )
  emoji_dark_skin_tone: emoji_dark_skin_tone {
    compatible = "zmk,behavior-mod-morph";
    #binding-cells = <0>;
    bindings = <&emoji_dark_skin_tone_macro>, <&emoji_dark_skin_tone_macro>;
    mods = <(~(
#ifdef WORLD_USE_COMPOSE_FOR_emoji_dark_skin_tone
  COMPOSE_MORPH_MODS
#else
  UNICODE_MORPH_MODS
#endif
))>;
  };
  UNICODE(emoji_baby_bottle_macro, /* 🍼 */
    #if OPERATING_SYSTEM == 'L'
      UNICODE_SEQ_LINUX(&kp _N1 &kp _NF &kp _N3 &kp _N7 &kp _NC)
    #elif OPERATING_SYSTEM == 'M'
      UNICODE_SEQ_MACOS(&kp _ND &kp _N8 &kp _N3 &kp _NC &kp _ND &kp _NF &kp _N7 &kp _NC)
    #elif OPERATING_SYSTEM == 'W'
      UNICODE_SEQ_WINDOWS(&kp _N0 &kp _N1 &kp _NF &kp _N3 &kp _N7 &kp _NC)
    #endif
  )
  emoji_baby_bottle: emoji_baby_bottle {
    compatible = "zmk,behavior-mod-morph";
    #binding-cells = <0>;
    bindings = <&emoji_baby_bottle_macro>, <&emoji_baby_bottle_macro>;
    mods = <(~(
#ifdef WORLD_USE_COMPOSE_FOR_emoji_baby_bottle
  COMPOSE_MORPH_MODS
#else
  UNICODE_MORPH_MODS
#endif
))>;
  };
  UNICODE(emoji_baby_macro, /* 👶 */
    #if OPERATING_SYSTEM == 'L'
      UNICODE_SEQ_LINUX(&kp _N1 &kp _NF &kp _N4 &kp _N7 &kp _N6)
    #elif OPERATING_SYSTEM == 'M'
      UNICODE_SEQ_MACOS(&kp _ND &kp _N8 &kp _N3 &kp _ND &kp _ND &kp _NC &kp _N7 &kp _N6)
    #elif OPERATING_SYSTEM == 'W'
      UNICODE_SEQ_WINDOWS(&kp _N0 &kp _N1 &kp _NF &kp _N4 &kp _N7 &kp _N6)
    #endif
  )
  emoji_baby: emoji_baby {
    compatible = "zmk,behavior-mod-morph";
    #binding-cells = <0>;
    bindings = <&emoji_baby_macro>, <&emoji_baby_macro>;
    mods = <(~(
#ifdef WORLD_USE_COMPOSE_FOR_emoji_baby
  COMPOSE_MORPH_MODS
#else
  UNICODE_MORPH_MODS
#endif
))>;
  };
  UNICODE(emoji_boy_macro, /* 👦 */
    #if OPERATING_SYSTEM == 'L'
      UNICODE_SEQ_LINUX(&kp _N1 &kp _NF &kp _N4 &kp _N6 &kp _N6)
    #elif OPERATING_SYSTEM == 'M'
      UNICODE_SEQ_MACOS(&kp _ND &kp _N8 &kp _N3 &kp _ND &kp _ND &kp _NC &kp _N6 &kp _N6)
    #elif OPERATING_SYSTEM == 'W'
      UNICODE_SEQ_WINDOWS(&kp _N0 &kp _N1 &kp _NF &kp _N4 &kp _N6 &kp _N6)
    #endif
  )
  emoji_boy: emoji_boy {
    compatible = "zmk,behavior-mod-morph";
    #binding-cells = <0>;
    bindings = <&emoji_boy_macro>, <&emoji_boy_macro>;
    mods = <(~(
#ifdef WORLD_USE_COMPOSE_FOR_emoji_boy
  COMPOSE_MORPH_MODS
#else
  UNICODE_MORPH_MODS
#endif
))>;
  };
  UNICODE(emoji_girl_macro, /* 👧 */
    #if OPERATING_SYSTEM == 'L'
      UNICODE_SEQ_LINUX(&kp _N1 &kp _NF &kp _N4 &kp _N6 &kp _N7)
    #elif OPERATING_SYSTEM == 'M'
      UNICODE_SEQ_MACOS(&kp _ND &kp _N8 &kp _N3 &kp _ND &kp _ND &kp _NC &kp _N6 &kp _N7)
    #elif OPERATING_SYSTEM == 'W'
      UNICODE_SEQ_WINDOWS(&kp _N0 &kp _N1 &kp _NF &kp _N4 &kp _N6 &kp _N7)
    #endif
  )
  emoji_girl: emoji_girl {
    compatible = "zmk,behavior-mod-morph";
    #binding-cells = <0>;
    bindings = <&emoji_girl_macro>, <&emoji_girl_macro>;
    mods = <(~(
#ifdef WORLD_USE_COMPOSE_FOR_emoji_girl
  COMPOSE_MORPH_MODS
#else
  UNICODE_MORPH_MODS
#endif
))>;
  };
  UNICODE(emoji_man_macro, /* 👨 */
    #if OPERATING_SYSTEM == 'L'
      UNICODE_SEQ_LINUX(&kp _N1 &kp _NF &kp _N4 &kp _N6 &kp _N8)
    #elif OPERATING_SYSTEM == 'M'
      UNICODE_SEQ_MACOS(&kp _ND &kp _N8 &kp _N3 &kp _ND &kp _ND &kp _NC &kp _N6 &kp _N8)
    #elif OPERATING_SYSTEM == 'W'
      UNICODE_SEQ_WINDOWS(&kp _N0 &kp _N1 &kp _NF &kp _N4 &kp _N6 &kp _N8)
    #endif
  )
  emoji_man: emoji_man {
    compatible = "zmk,behavior-mod-morph";
    #binding-cells = <0>;
    bindings = <&emoji_man_macro>, <&emoji_man_macro>;
    mods = <(~(
#ifdef WORLD_USE_COMPOSE_FOR_emoji_man
  COMPOSE_MORPH_MODS
#else
  UNICODE_MORPH_MODS
#endif
))>;
  };
  UNICODE(emoji_woman_macro, /* 👩 */
    #if OPERATING_SYSTEM == 'L'
      UNICODE_SEQ_LINUX(&kp _N1 &kp _NF &kp _N4 &kp _N6 &kp _N9)
    #elif OPERATING_SYSTEM == 'M'
      UNICODE_SEQ_MACOS(&kp _ND &kp _N8 &kp _N3 &kp _ND &kp _ND &kp _NC &kp _N6 &kp _N9)
    #elif OPERATING_SYSTEM == 'W'
      UNICODE_SEQ_WINDOWS(&kp _N0 &kp _N1 &kp _NF &kp _N4 &kp _N6 &kp _N9)
    #endif
  )
  emoji_woman: emoji_woman {
    compatible = "zmk,behavior-mod-morph";
    #binding-cells = <0>;
    bindings = <&emoji_woman_macro>, <&emoji_woman_macro>;
    mods = <(~(
#ifdef WORLD_USE_COMPOSE_FOR_emoji_woman
  COMPOSE_MORPH_MODS
#else
  UNICODE_MORPH_MODS
#endif
))>;
  };
  UNICODE(emoji_old_man_macro, /* 👴 */
    #if OPERATING_SYSTEM == 'L'
      UNICODE_SEQ_LINUX(&kp _N1 &kp _NF &kp _N4 &kp _N7 &kp _N4)
    #elif OPERATING_SYSTEM == 'M'
      UNICODE_SEQ_MACOS(&kp _ND &kp _N8 &kp _N3 &kp _ND &kp _ND &kp _NC &kp _N7 &kp _N4)
    #elif OPERATING_SYSTEM == 'W'
      UNICODE_SEQ_WINDOWS(&kp _N0 &kp _N1 &kp _NF &kp _N4 &kp _N7 &kp _N4)
    #endif
  )
  emoji_old_man: emoji_old_man {
    compatible = "zmk,behavior-mod-morph";
    #binding-cells = <0>;
    bindings = <&emoji_old_man_macro>, <&emoji_old_man_macro>;
    mods = <(~(
#ifdef WORLD_USE_COMPOSE_FOR_emoji_old_man
  COMPOSE_MORPH_MODS
#else
  UNICODE_MORPH_MODS
#endif
))>;
  };
  UNICODE(emoji_old_woman_macro, /* 👵 */
    #if OPERATING_SYSTEM == 'L'
      UNICODE_SEQ_LINUX(&kp _N1 &kp _NF &kp _N4 &kp _N7 &kp _N5)
    #elif OPERATING_SYSTEM == 'M'
      UNICODE_SEQ_MACOS(&kp _ND &kp _N8 &kp _N3 &kp _ND &kp _ND &kp _NC &kp _N7 &kp _N5)
    #elif OPERATING_SYSTEM == 'W'
      UNICODE_SEQ_WINDOWS(&kp _N0 &kp _N1 &kp _NF &kp _N4 &kp _N7 &kp _N5)
    #endif
  )
  emoji_old_woman: emoji_old_woman {
    compatible = "zmk,behavior-mod-morph";
    #binding-cells = <0>;
    bindings = <&emoji_old_woman_macro>, <&emoji_old_woman_macro>;
    mods = <(~(
#ifdef WORLD_USE_COMPOSE_FOR_emoji_old_woman
  COMPOSE_MORPH_MODS
#else
  UNICODE_MORPH_MODS
#endif
))>;
  };
  UNICODE(emoji_white_hair_macro, /* 🦳 */
    #if OPERATING_SYSTEM == 'L'
      UNICODE_SEQ_LINUX(&kp _N1 &kp _NF &kp _N9 &kp _NB &kp _N3)
    #elif OPERATING_SYSTEM == 'M'
      UNICODE_SEQ_MACOS(&kp _ND &kp _N8 &kp _N3 &kp _NE &kp _ND &kp _ND &kp _NB &kp _N3)
    #elif OPERATING_SYSTEM == 'W'
      UNICODE_SEQ_WINDOWS(&kp _N0 &kp _N1 &kp _NF &kp _N9 &kp _NB &kp _N3)
    #endif
  )
  emoji_white_hair: emoji_white_hair {
    compatible = "zmk,behavior-mod-morph";
    #binding-cells = <0>;
    bindings = <&emoji_white_hair_macro>, <&emoji_white_hair_macro>;
    mods = <(~(
#ifdef WORLD_USE_COMPOSE_FOR_emoji_white_hair
  COMPOSE_MORPH_MODS
#else
  UNICODE_MORPH_MODS
#endif
))>;
  };
  UNICODE(emoji_curly_hair_macro, /* 🦱 */
    #if OPERATING_SYSTEM == 'L'
      UNICODE_SEQ_LINUX(&kp _N1 &kp _NF &kp _N9 &kp _NB &kp _N1)
    #elif OPERATING_SYSTEM == 'M'
      UNICODE_SEQ_MACOS(&kp _ND &kp _N8 &kp _N3 &kp _NE &kp _ND &kp _ND &kp _NB &kp _N1)
    #elif OPERATING_SYSTEM == 'W'
      UNICODE_SEQ_WINDOWS(&kp _N0 &kp _N1 &kp _NF &kp _N9 &kp _NB &kp _N1)
    #endif
  )
  emoji_curly_hair: emoji_curly_hair {
    compatible = "zmk,behavior-mod-morph";
    #binding-cells = <0>;
    bindings = <&emoji_curly_hair_macro>, <&emoji_curly_hair_macro>;
    mods = <(~(
#ifdef WORLD_USE_COMPOSE_FOR_emoji_curly_hair
  COMPOSE_MORPH_MODS
#else
  UNICODE_MORPH_MODS
#endif
))>;
  };
  UNICODE(emoji_red_hair_macro, /* 🦰 */
    #if OPERATING_SYSTEM == 'L'
      UNICODE_SEQ_LINUX(&kp _N1 &kp _NF &kp _N9 &kp _NB &kp _N0)
    #elif OPERATING_SYSTEM == 'M'
      UNICODE_SEQ_MACOS(&kp _ND &kp _N8 &kp _N3 &kp _NE &kp _ND &kp _ND &kp _NB &kp _N0)
    #elif OPERATING_SYSTEM == 'W'
      UNICODE_SEQ_WINDOWS(&kp _N0 &kp _N1 &kp _NF &kp _N9 &kp _NB &kp _N0)
    #endif
  )
  emoji_red_hair: emoji_red_hair {
    compatible = "zmk,behavior-mod-morph";
    #binding-cells = <0>;
    bindings = <&emoji_red_hair_macro>, <&emoji_red_hair_macro>;
    mods = <(~(
#ifdef WORLD_USE_COMPOSE_FOR_emoji_red_hair
  COMPOSE_MORPH_MODS
#else
  UNICODE_MORPH_MODS
#endif
))>;
  };
  UNICODE(emoji_bald_macro, /* 🦲 */
    #if OPERATING_SYSTEM == 'L'
      UNICODE_SEQ_LINUX(&kp _N1 &kp _NF &kp _N9 &kp _NB &kp _N2)
    #elif OPERATING_SYSTEM == 'M'
      UNICODE_SEQ_MACOS(&kp _ND &kp _N8 &kp _N3 &kp _NE &kp _ND &kp _ND &kp _NB &kp _N2)
    #elif OPERATING_SYSTEM == 'W'
      UNICODE_SEQ_WINDOWS(&kp _N0 &kp _N1 &kp _NF &kp _N9 &kp _NB &kp _N2)
    #endif
  )
  emoji_bald: emoji_bald {
    compatible = "zmk,behavior-mod-morph";
    #binding-cells = <0>;
    bindings = <&emoji_bald_macro>, <&emoji_bald_macro>;
    mods = <(~(
#ifdef WORLD_USE_COMPOSE_FOR_emoji_bald
  COMPOSE_MORPH_MODS
#else
  UNICODE_MORPH_MODS
#endif
))>;
  };
  UNICODE(emoji_new_moon_macro, /* 🌑 */
    #if OPERATING_SYSTEM == 'L'
      UNICODE_SEQ_LINUX(&kp _N1 &kp _NF &kp _N3 &kp _N1 &kp _N1)
    #elif OPERATING_SYSTEM == 'M'
      UNICODE_SEQ_MACOS(&kp _ND &kp _N8 &kp _N3 &kp _NC &kp _ND &kp _NF &kp _N1 &kp _N1)
    #elif OPERATING_SYSTEM == 'W'
      UNICODE_SEQ_WINDOWS(&kp _N0 &kp _N1 &kp _NF &kp _N3 &kp _N1 &kp _N1)
    #endif
  )
  emoji_new_moon: emoji_new_moon {
    compatible = "zmk,behavior-mod-morph";
    #binding-cells = <0>;
    bindings = <&emoji_new_moon_macro>, <&emoji_new_moon_macro>;
    mods = <(~(
#ifdef WORLD_USE_COMPOSE_FOR_emoji_new_moon
  COMPOSE_MORPH_MODS
#else
  UNICODE_MORPH_MODS
#endif
))>;
  };
  UNICODE(emoji_waxing_crescent_moon_macro, /* 🌒 */
    #if OPERATING_SYSTEM == 'L'
      UNICODE_SEQ_LINUX(&kp _N1 &kp _NF &kp _N3 &kp _N1 &kp _N2)
    #elif OPERATING_SYSTEM == 'M'
      UNICODE_SEQ_MACOS(&kp _ND &kp _N8 &kp _N3 &kp _NC &kp _ND &kp _NF &kp _N1 &kp _N2)
    #elif OPERATING_SYSTEM == 'W'
      UNICODE_SEQ_WINDOWS(&kp _N0 &kp _N1 &kp _NF &kp _N3 &kp _N1 &kp _N2)
    #endif
  )
  emoji_waxing_crescent_moon: emoji_waxing_crescent_moon {
    compatible = "zmk,behavior-mod-morph";
    #binding-cells = <0>;
    bindings = <&emoji_waxing_crescent_moon_macro>, <&emoji_waxing_crescent_moon_macro>;
    mods = <(~(
#ifdef WORLD_USE_COMPOSE_FOR_emoji_waxing_crescent_moon
  COMPOSE_MORPH_MODS
#else
  UNICODE_MORPH_MODS
#endif
))>;
  };
  UNICODE(emoji_first_quarter_moon_macro, /* 🌓 */
    #if OPERATING_SYSTEM == 'L'
      UNICODE_SEQ_LINUX(&kp _N1 &kp _NF &kp _N3 &kp _N1 &kp _N3)
    #elif OPERATING_SYSTEM == 'M'
      UNICODE_SEQ_MACOS(&kp _ND &kp _N8 &kp _N3 &kp _NC &kp _ND &kp _NF &kp _N1 &kp _N3)
    #elif OPERATING_SYSTEM == 'W'
      UNICODE_SEQ_WINDOWS(&kp _N0 &kp _N1 &kp _NF &kp _N3 &kp _N1 &kp _N3)
    #endif
  )
  emoji_first_quarter_moon: emoji_first_quarter_moon {
    compatible = "zmk,behavior-mod-morph";
    #binding-cells = <0>;
    bindings = <&emoji_first_quarter_moon_macro>, <&emoji_first_quarter_moon_macro>;
    mods = <(~(
#ifdef WORLD_USE_COMPOSE_FOR_emoji_first_quarter_moon
  COMPOSE_MORPH_MODS
#else
  UNICODE_MORPH_MODS
#endif
))>;
  };
  UNICODE(emoji_waxing_gibbous_moon_macro, /* 🌔 */
    #if OPERATING_SYSTEM == 'L'
      UNICODE_SEQ_LINUX(&kp _N1 &kp _NF &kp _N3 &kp _N1 &kp _N4)
    #elif OPERATING_SYSTEM == 'M'
      UNICODE_SEQ_MACOS(&kp _ND &kp _N8 &kp _N3 &kp _NC &kp _ND &kp _NF &kp _N1 &kp _N4)
    #elif OPERATING_SYSTEM == 'W'
      UNICODE_SEQ_WINDOWS(&kp _N0 &kp _N1 &kp _NF &kp _N3 &kp _N1 &kp _N4)
    #endif
  )
  emoji_waxing_gibbous_moon: emoji_waxing_gibbous_moon {
    compatible = "zmk,behavior-mod-morph";
    #binding-cells = <0>;
    bindings = <&emoji_waxing_gibbous_moon_macro>, <&emoji_waxing_gibbous_moon_macro>;
    mods = <(~(
#ifdef WORLD_USE_COMPOSE_FOR_emoji_waxing_gibbous_moon
  COMPOSE_MORPH_MODS
#else
  UNICODE_MORPH_MODS
#endif
))>;
  };
  UNICODE(emoji_full_moon_macro, /* 🌕 */
    #if OPERATING_SYSTEM == 'L'
      UNICODE_SEQ_LINUX(&kp _N1 &kp _NF &kp _N3 &kp _N1 &kp _N5)
    #elif OPERATING_SYSTEM == 'M'
      UNICODE_SEQ_MACOS(&kp _ND &kp _N8 &kp _N3 &kp _NC &kp _ND &kp _NF &kp _N1 &kp _N5)
    #elif OPERATING_SYSTEM == 'W'
      UNICODE_SEQ_WINDOWS(&kp _N0 &kp _N1 &kp _NF &kp _N3 &kp _N1 &kp _N5)
    #endif
  )
  emoji_full_moon: emoji_full_moon {
    compatible = "zmk,behavior-mod-morph";
    #binding-cells = <0>;
    bindings = <&emoji_full_moon_macro>, <&emoji_full_moon_macro>;
    mods = <(~(
#ifdef WORLD_USE_COMPOSE_FOR_emoji_full_moon
  COMPOSE_MORPH_MODS
#else
  UNICODE_MORPH_MODS
#endif
))>;
  };
  UNICODE(emoji_waning_gibbous_moon_macro, /* 🌖 */
    #if OPERATING_SYSTEM == 'L'
      UNICODE_SEQ_LINUX(&kp _N1 &kp _NF &kp _N3 &kp _N1 &kp _N6)
    #elif OPERATING_SYSTEM == 'M'
      UNICODE_SEQ_MACOS(&kp _ND &kp _N8 &kp _N3 &kp _NC &kp _ND &kp _NF &kp _N1 &kp _N6)
    #elif OPERATING_SYSTEM == 'W'
      UNICODE_SEQ_WINDOWS(&kp _N0 &kp _N1 &kp _NF &kp _N3 &kp _N1 &kp _N6)
    #endif
  )
  emoji_waning_gibbous_moon: emoji_waning_gibbous_moon {
    compatible = "zmk,behavior-mod-morph";
    #binding-cells = <0>;
    bindings = <&emoji_waning_gibbous_moon_macro>, <&emoji_waning_gibbous_moon_macro>;
    mods = <(~(
#ifdef WORLD_USE_COMPOSE_FOR_emoji_waning_gibbous_moon
  COMPOSE_MORPH_MODS
#else
  UNICODE_MORPH_MODS
#endif
))>;
  };
  UNICODE(emoji_last_quarter_moon_macro, /* 🌗 */
    #if OPERATING_SYSTEM == 'L'
      UNICODE_SEQ_LINUX(&kp _N1 &kp _NF &kp _N3 &kp _N1 &kp _N7)
    #elif OPERATING_SYSTEM == 'M'
      UNICODE_SEQ_MACOS(&kp _ND &kp _N8 &kp _N3 &kp _NC &kp _ND &kp _NF &kp _N1 &kp _N7)
    #elif OPERATING_SYSTEM == 'W'
      UNICODE_SEQ_WINDOWS(&kp _N0 &kp _N1 &kp _NF &kp _N3 &kp _N1 &kp _N7)
    #endif
  )
  emoji_last_quarter_moon: emoji_last_quarter_moon {
    compatible = "zmk,behavior-mod-morph";
    #binding-cells = <0>;
    bindings = <&emoji_last_quarter_moon_macro>, <&emoji_last_quarter_moon_macro>;
    mods = <(~(
#ifdef WORLD_USE_COMPOSE_FOR_emoji_last_quarter_moon
  COMPOSE_MORPH_MODS
#else
  UNICODE_MORPH_MODS
#endif
))>;
  };
  UNICODE(emoji_waning_crescent_moon_macro, /* 🌘 */
    #if OPERATING_SYSTEM == 'L'
      UNICODE_SEQ_LINUX(&kp _N1 &kp _NF &kp _N3 &kp _N1 &kp _N8)
    #elif OPERATING_SYSTEM == 'M'
      UNICODE_SEQ_MACOS(&kp _ND &kp _N8 &kp _N3 &kp _NC &kp _ND &kp _NF &kp _N1 &kp _N8)
    #elif OPERATING_SYSTEM == 'W'
      UNICODE_SEQ_WINDOWS(&kp _N0 &kp _N1 &kp _NF &kp _N3 &kp _N1 &kp _N8)
    #endif
  )
  emoji_waning_crescent_moon: emoji_waning_crescent_moon {
    compatible = "zmk,behavior-mod-morph";
    #binding-cells = <0>;
    bindings = <&emoji_waning_crescent_moon_macro>, <&emoji_waning_crescent_moon_macro>;
    mods = <(~(
#ifdef WORLD_USE_COMPOSE_FOR_emoji_waning_crescent_moon
  COMPOSE_MORPH_MODS
#else
  UNICODE_MORPH_MODS
#endif
))>;
  };
  UNICODE(emoji_tada_macro, /* 🎉 */
    #if OPERATING_SYSTEM == 'L'
      UNICODE_SEQ_LINUX(&kp _N1 &kp _NF &kp _N3 &kp _N8 &kp _N9)
    #elif OPERATING_SYSTEM == 'M'
      UNICODE_SEQ_MACOS(&kp _ND &kp _N8 &kp _N3 &kp _NC &kp _ND &kp _NF &kp _N8 &kp _N9)
    #elif OPERATING_SYSTEM == 'W'
      UNICODE_SEQ_WINDOWS(&kp _N0 &kp _N1 &kp _NF &kp _N3 &kp _N8 &kp _N9)
    #endif
  )
  emoji_tada: emoji_tada {
    compatible = "zmk,behavior-mod-morph";
    #binding-cells = <0>;
    bindings = <&emoji_tada_macro>, <&emoji_tada_macro>;
    mods = <(~(
#ifdef WORLD_USE_COMPOSE_FOR_emoji_tada
  COMPOSE_MORPH_MODS
#else
  UNICODE_MORPH_MODS
#endif
))>;
  };
  UNICODE(emoji_heart_macro, /* ️❤️ */
    #if OPERATING_SYSTEM == 'L'
      UNICODE_SEQ_LINUX(&kp _NF &kp _NE &kp _N0 &kp _NF), <&macro_wait_time UNICODE_SEQ_DELAY>, UNICODE_SEQ_LINUX(&kp _N2 &kp _N7 &kp _N6 &kp _N4), UNICODE_SEQ_LINUX(&kp _NF &kp _NE &kp _N0 &kp _NF)
    #elif OPERATING_SYSTEM == 'M'
      UNICODE_SEQ_MACOS(&kp _NF &kp _NE &kp _N0 &kp _NF), <&macro_wait_time UNICODE_SEQ_DELAY>, UNICODE_SEQ_MACOS(&kp _N2 &kp _N7 &kp _N6 &kp _N4), UNICODE_SEQ_MACOS(&kp _NF &kp _NE &kp _N0 &kp _NF)
    #elif OPERATING_SYSTEM == 'W'
      UNICODE_SEQ_WINDOWS(&kp _N0 &kp _NF &kp _NE &kp _N0 &kp _NF), <&macro_wait_time UNICODE_SEQ_DELAY>, UNICODE_SEQ_WINDOWS(&kp _N0 &kp _N2 &kp _N7 &kp _N6 &kp _N4), UNICODE_SEQ_WINDOWS(&kp _N0 &kp _NF &kp _NE &kp _N0 &kp _NF)
    #endif
  )
  emoji_heart: emoji_heart {
    compatible = "zmk,behavior-mod-morph";
    #binding-cells = <0>;
    bindings = <&emoji_heart_macro>, <&emoji_heart_macro>;
    mods = <(~(
#ifdef WORLD_USE_COMPOSE_FOR_emoji_heart
  COMPOSE_MORPH_MODS
#else
  UNICODE_MORPH_MODS
#endif
))>;
  };
  UNICODE(emoji_fire_macro, /* 🔥 */
    #if OPERATING_SYSTEM == 'L'
      UNICODE_SEQ_LINUX(&kp _N1 &kp _NF &kp _N5 &kp _N2 &kp _N5)
    #elif OPERATING_SYSTEM == 'M'
      UNICODE_SEQ_MACOS(&kp _ND &kp _N8 &kp _N3 &kp _ND &kp _ND &kp _ND &kp _N2 &kp _N5)
    #elif OPERATING_SYSTEM == 'W'
      UNICODE_SEQ_WINDOWS(&kp _N0 &kp _N1 &kp _NF &kp _N5 &kp _N2 &kp _N5)
    #endif
  )
  emoji_fire: emoji_fire {
    compatible = "zmk,behavior-mod-morph";
    #binding-cells = <0>;
    bindings = <&emoji_fire_macro>, <&emoji_fire_macro>;
    mods = <(~(
#ifdef WORLD_USE_COMPOSE_FOR_emoji_fire
  COMPOSE_MORPH_MODS
#else
  UNICODE_MORPH_MODS
#endif
))>;
  };
  UNICODE(emoji_muscle_macro, /* 💪 */
    #if OPERATING_SYSTEM == 'L'
      UNICODE_SEQ_LINUX(&kp _N1 &kp _NF &kp _N4 &kp _NA &kp _NA)
    #elif OPERATING_SYSTEM == 'M'
      UNICODE_SEQ_MACOS(&kp _ND &kp _N8 &kp _N3 &kp _ND &kp _ND &kp _NC &kp _NA &kp _NA)
    #elif OPERATING_SYSTEM == 'W'
      UNICODE_SEQ_WINDOWS(&kp _N0 &kp _N1 &kp _NF &kp _N4 &kp _NA &kp _NA)
    #endif
  )
  emoji_muscle: emoji_muscle {
    compatible = "zmk,behavior-mod-morph";
    #binding-cells = <0>;
    bindings = <&emoji_muscle_macro>, <&emoji_muscle_macro>;
    mods = <(~(
#ifdef WORLD_USE_COMPOSE_FOR_emoji_muscle
  COMPOSE_MORPH_MODS
#else
  UNICODE_MORPH_MODS
#endif
))>;
  };
  UNICODE(emoji_person_climbing_macro, /* 🧗 */
    #if OPERATING_SYSTEM == 'L'
      UNICODE_SEQ_LINUX(&kp _N1 &kp _NF &kp _N9 &kp _ND &kp _N7)
    #elif OPERATING_SYSTEM == 'M'
      UNICODE_SEQ_MACOS(&kp _ND &kp _N8 &kp _N3 &kp _NE &kp _ND &kp _ND &kp _ND &kp _N7)
    #elif OPERATING_SYSTEM == 'W'
      UNICODE_SEQ_WINDOWS(&kp _N0 &kp _N1 &kp _NF &kp _N9 &kp _ND &kp _N7)
    #endif
  )
  emoji_person_climbing: emoji_person_climbing {
    compatible = "zmk,behavior-mod-morph";
    #binding-cells = <0>;
    bindings = <&emoji_person_climbing_macro>, <&emoji_person_climbing_macro>;
    mods = <(~(
#ifdef WORLD_USE_COMPOSE_FOR_emoji_person_climbing
  COMPOSE_MORPH_MODS
#else
  UNICODE_MORPH_MODS
#endif
))>;
  };
  UNICODE(emoji_lab_coat_macro, /* 🥼 */
    #if OPERATING_SYSTEM == 'L'
      UNICODE_SEQ_LINUX(&kp _N1 &kp _NF &kp _N9 &kp _N7 &kp _NC)
    #elif OPERATING_SYSTEM == 'M'
      UNICODE_SEQ_MACOS(&kp _ND &kp _N8 &kp _N3 &kp _NE &kp _ND &kp _ND &kp _N7 &kp _NC)
    #elif OPERATING_SYSTEM == 'W'
      UNICODE_SEQ_WINDOWS(&kp _N0 &kp _N1 &kp _NF &kp _N9 &kp _N7 &kp _NC)
    #endif
  )
  emoji_lab_coat: emoji_lab_coat {
    compatible = "zmk,behavior-mod-morph";
    #binding-cells = <0>;
    bindings = <&emoji_lab_coat_macro>, <&emoji_lab_coat_macro>;
    mods = <(~(
#ifdef WORLD_USE_COMPOSE_FOR_emoji_lab_coat
  COMPOSE_MORPH_MODS
#else
  UNICODE_MORPH_MODS
#endif
))>;
  };
  UNICODE(emoji_rocket_macro, /* 🚀 */
    #if OPERATING_SYSTEM == 'L'
      UNICODE_SEQ_LINUX(&kp _N1 &kp _NF &kp _N6 &kp _N8 &kp _N0)
    #elif OPERATING_SYSTEM == 'M'
      UNICODE_SEQ_MACOS(&kp _ND &kp _N8 &kp _N3 &kp _ND &kp _ND &kp _NE &kp _N8 &kp _N0)
    #elif OPERATING_SYSTEM == 'W'
      UNICODE_SEQ_WINDOWS(&kp _N0 &kp _N1 &kp _NF &kp _N6 &kp _N8 &kp _N0)
    #endif
  )
  emoji_rocket: emoji_rocket {
    compatible = "zmk,behavior-mod-morph";
    #binding-cells = <0>;
    bindings = <&emoji_rocket_macro>, <&emoji_rocket_macro>;
    mods = <(~(
#ifdef WORLD_USE_COMPOSE_FOR_emoji_rocket
  COMPOSE_MORPH_MODS
#else
  UNICODE_MORPH_MODS
#endif
))>;
  };
  UNICODE(emoji_joy_macro, /* 😂 */
    #if OPERATING_SYSTEM == 'L'
      UNICODE_SEQ_LINUX(&kp _N1 &kp _NF &kp _N6 &kp _N0 &kp _N2)
    #elif OPERATING_SYSTEM == 'M'
      UNICODE_SEQ_MACOS(&kp _ND &kp _N8 &kp _N3 &kp _ND &kp _ND &kp _NE &kp _N0 &kp _N2)
    #elif OPERATING_SYSTEM == 'W'
      UNICODE_SEQ_WINDOWS(&kp _N0 &kp _N1 &kp _NF &kp _N6 &kp _N0 &kp _N2)
    #endif
  )
  emoji_joy: emoji_joy {
    compatible = "zmk,behavior-mod-morph";
    #binding-cells = <0>;
    bindings = <&emoji_joy_macro>, <&emoji_joy_macro>;
    mods = <(~(
#ifdef WORLD_USE_COMPOSE_FOR_emoji_joy
  COMPOSE_MORPH_MODS
#else
  UNICODE_MORPH_MODS
#endif
))>;
  };
  UNICODE(emoji_rofl_macro, /* 🤣 */
    #if OPERATING_SYSTEM == 'L'
      UNICODE_SEQ_LINUX(&kp _N1 &kp _NF &kp _N9 &kp _N2 &kp _N3)
    #elif OPERATING_SYSTEM == 'M'
      UNICODE_SEQ_MACOS(&kp _ND &kp _N8 &kp _N3 &kp _NE &kp _ND &kp _ND &kp _N2 &kp _N3)
    #elif OPERATING_SYSTEM == 'W'
      UNICODE_SEQ_WINDOWS(&kp _N0 &kp _N1 &kp _NF &kp _N9 &kp _N2 &kp _N3)
    #endif
  )
  emoji_rofl: emoji_rofl {
    compatible = "zmk,behavior-mod-morph";
    #binding-cells = <0>;
    bindings = <&emoji_rofl_macro>, <&emoji_rofl_macro>;
    mods = <(~(
#ifdef WORLD_USE_COMPOSE_FOR_emoji_rofl
  COMPOSE_MORPH_MODS
#else
  UNICODE_MORPH_MODS
#endif
))>;
  };
  UNICODE(emoji_star_struck_macro, /* 🤩 */
    #if OPERATING_SYSTEM == 'L'
      UNICODE_SEQ_LINUX(&kp _N1 &kp _NF &kp _N9 &kp _N2 &kp _N9)
    #elif OPERATING_SYSTEM == 'M'
      UNICODE_SEQ_MACOS(&kp _ND &kp _N8 &kp _N3 &kp _NE &kp _ND &kp _ND &kp _N2 &kp _N9)
    #elif OPERATING_SYSTEM == 'W'
      UNICODE_SEQ_WINDOWS(&kp _N0 &kp _N1 &kp _NF &kp _N9 &kp _N2 &kp _N9)
    #endif
  )
  emoji_star_struck: emoji_star_struck {
    compatible = "zmk,behavior-mod-morph";
    #binding-cells = <0>;
    bindings = <&emoji_star_struck_macro>, <&emoji_star_struck_macro>;
    mods = <(~(
#ifdef WORLD_USE_COMPOSE_FOR_emoji_star_struck
  COMPOSE_MORPH_MODS
#else
  UNICODE_MORPH_MODS
#endif
))>;
  };
  UNICODE(emoji_love_struck_macro, /* 😍 */
    #if OPERATING_SYSTEM == 'L'
      UNICODE_SEQ_LINUX(&kp _N1 &kp _NF &kp _N6 &kp _N0 &kp _ND)
    #elif OPERATING_SYSTEM == 'M'
      UNICODE_SEQ_MACOS(&kp _ND &kp _N8 &kp _N3 &kp _ND &kp _ND &kp _NE &kp _N0 &kp _ND)
    #elif OPERATING_SYSTEM == 'W'
      UNICODE_SEQ_WINDOWS(&kp _N0 &kp _N1 &kp _NF &kp _N6 &kp _N0 &kp _ND)
    #endif
  )
  emoji_love_struck: emoji_love_struck {
    compatible = "zmk,behavior-mod-morph";
    #binding-cells = <0>;
    bindings = <&emoji_love_struck_macro>, <&emoji_love_struck_macro>;
    mods = <(~(
#ifdef WORLD_USE_COMPOSE_FOR_emoji_love_struck
  COMPOSE_MORPH_MODS
#else
  UNICODE_MORPH_MODS
#endif
))>;
  };
  UNICODE(emoji_saluting_face_macro, /* 🫡 */
    #if OPERATING_SYSTEM == 'L'
      UNICODE_SEQ_LINUX(&kp _N1 &kp _NF &kp _NA &kp _NE &kp _N1)
    #elif OPERATING_SYSTEM == 'M'
      UNICODE_SEQ_MACOS(&kp _ND &kp _N8 &kp _N3 &kp _NE &kp _ND &kp _NE &kp _NE &kp _N1)
    #elif OPERATING_SYSTEM == 'W'
      UNICODE_SEQ_WINDOWS(&kp _N0 &kp _N1 &kp _NF &kp _NA &kp _NE &kp _N1)
    #endif
  )
  emoji_saluting_face: emoji_saluting_face {
    compatible = "zmk,behavior-mod-morph";
    #binding-cells = <0>;
    bindings = <&emoji_saluting_face_macro>, <&emoji_saluting_face_macro>;
    mods = <(~(
#ifdef WORLD_USE_COMPOSE_FOR_emoji_saluting_face
  COMPOSE_MORPH_MODS
#else
  UNICODE_MORPH_MODS
#endif
))>;
  };
  UNICODE(emoji_shocked_face_macro, /* 🤯 */
    #if OPERATING_SYSTEM == 'L'
      UNICODE_SEQ_LINUX(&kp _N1 &kp _NF &kp _N9 &kp _N2 &kp _NF)
    #elif OPERATING_SYSTEM == 'M'
      UNICODE_SEQ_MACOS(&kp _ND &kp _N8 &kp _N3 &kp _NE &kp _ND &kp _ND &kp _N2 &kp _NF)
    #elif OPERATING_SYSTEM == 'W'
      UNICODE_SEQ_WINDOWS(&kp _N0 &kp _N1 &kp _NF &kp _N9 &kp _N2 &kp _NF)
    #endif
  )
  emoji_shocked_face: emoji_shocked_face {
    compatible = "zmk,behavior-mod-morph";
    #binding-cells = <0>;
    bindings = <&emoji_shocked_face_macro>, <&emoji_shocked_face_macro>;
    mods = <(~(
#ifdef WORLD_USE_COMPOSE_FOR_emoji_shocked_face
  COMPOSE_MORPH_MODS
#else
  UNICODE_MORPH_MODS
#endif
))>;
  };
  UNICODE(emoji_cold_sweat_macro, /* 😰 */
    #if OPERATING_SYSTEM == 'L'
      UNICODE_SEQ_LINUX(&kp _N1 &kp _NF &kp _N6 &kp _N3 &kp _N0)
    #elif OPERATING_SYSTEM == 'M'
      UNICODE_SEQ_MACOS(&kp _ND &kp _N8 &kp _N3 &kp _ND &kp _ND &kp _NE &kp _N3 &kp _N0)
    #elif OPERATING_SYSTEM == 'W'
      UNICODE_SEQ_WINDOWS(&kp _N0 &kp _N1 &kp _NF &kp _N6 &kp _N3 &kp _N0)
    #endif
  )
  emoji_cold_sweat: emoji_cold_sweat {
    compatible = "zmk,behavior-mod-morph";
    #binding-cells = <0>;
    bindings = <&emoji_cold_sweat_macro>, <&emoji_cold_sweat_macro>;
    mods = <(~(
#ifdef WORLD_USE_COMPOSE_FOR_emoji_cold_sweat
  COMPOSE_MORPH_MODS
#else
  UNICODE_MORPH_MODS
#endif
))>;
  };
  UNICODE(emoji_monocle_face_macro, /* 🧐 */
    #if OPERATING_SYSTEM == 'L'
      UNICODE_SEQ_LINUX(&kp _N1 &kp _NF &kp _N9 &kp _ND &kp _N0)
    #elif OPERATING_SYSTEM == 'M'
      UNICODE_SEQ_MACOS(&kp _ND &kp _N8 &kp _N3 &kp _NE &kp _ND &kp _ND &kp _ND &kp _N0)
    #elif OPERATING_SYSTEM == 'W'
      UNICODE_SEQ_WINDOWS(&kp _N0 &kp _N1 &kp _NF &kp _N9 &kp _ND &kp _N0)
    #endif
  )
  emoji_monocle_face: emoji_monocle_face {
    compatible = "zmk,behavior-mod-morph";
    #binding-cells = <0>;
    bindings = <&emoji_monocle_face_macro>, <&emoji_monocle_face_macro>;
    mods = <(~(
#ifdef WORLD_USE_COMPOSE_FOR_emoji_monocle_face
  COMPOSE_MORPH_MODS
#else
  UNICODE_MORPH_MODS
#endif
))>;
  };
  UNICODE(emoji_snap_fingers_macro, /* 🫰 */
    #if OPERATING_SYSTEM == 'L'
      UNICODE_SEQ_LINUX(&kp _N1 &kp _NF &kp _NA &kp _NF &kp _N0)
    #elif OPERATING_SYSTEM == 'M'
      UNICODE_SEQ_MACOS(&kp _ND &kp _N8 &kp _N3 &kp _NE &kp _ND &kp _NE &kp _NF &kp _N0)
    #elif OPERATING_SYSTEM == 'W'
      UNICODE_SEQ_WINDOWS(&kp _N0 &kp _N1 &kp _NF &kp _NA &kp _NF &kp _N0)
    #endif
  )
  emoji_snap_fingers: emoji_snap_fingers {
    compatible = "zmk,behavior-mod-morph";
    #binding-cells = <0>;
    bindings = <&emoji_snap_fingers_macro>, <&emoji_snap_fingers_macro>;
    mods = <(~(
#ifdef WORLD_USE_COMPOSE_FOR_emoji_snap_fingers
  COMPOSE_MORPH_MODS
#else
  UNICODE_MORPH_MODS
#endif
))>;
  };
  UNICODE(emoji_ok_hand_macro, /* 👌 */
    #if OPERATING_SYSTEM == 'L'
      UNICODE_SEQ_LINUX(&kp _N1 &kp _NF &kp _N4 &kp _N4 &kp _NC)
    #elif OPERATING_SYSTEM == 'M'
      UNICODE_SEQ_MACOS(&kp _ND &kp _N8 &kp _N3 &kp _ND &kp _ND &kp _NC &kp _N4 &kp _NC)
    #elif OPERATING_SYSTEM == 'W'
      UNICODE_SEQ_WINDOWS(&kp _N0 &kp _N1 &kp _NF &kp _N4 &kp _N4 &kp _NC)
    #endif
  )
  emoji_ok_hand: emoji_ok_hand {
    compatible = "zmk,behavior-mod-morph";
    #binding-cells = <0>;
    bindings = <&emoji_ok_hand_macro>, <&emoji_ok_hand_macro>;
    mods = <(~(
#ifdef WORLD_USE_COMPOSE_FOR_emoji_ok_hand
  COMPOSE_MORPH_MODS
#else
  UNICODE_MORPH_MODS
#endif
))>;
  };
  UNICODE(emoji_pray_macro, /* 🙏 */
    #if OPERATING_SYSTEM == 'L'
      UNICODE_SEQ_LINUX(&kp _N1 &kp _NF &kp _N6 &kp _N4 &kp _NF)
    #elif OPERATING_SYSTEM == 'M'
      UNICODE_SEQ_MACOS(&kp _ND &kp _N8 &kp _N3 &kp _ND &kp _ND &kp _NE &kp _N4 &kp _NF)
    #elif OPERATING_SYSTEM == 'W'
      UNICODE_SEQ_WINDOWS(&kp _N0 &kp _N1 &kp _NF &kp _N6 &kp _N4 &kp _NF)
    #endif
  )
  emoji_pray: emoji_pray {
    compatible = "zmk,behavior-mod-morph";
    #binding-cells = <0>;
    bindings = <&emoji_pray_macro>, <&emoji_pray_macro>;
    mods = <(~(
#ifdef WORLD_USE_COMPOSE_FOR_emoji_pray
  COMPOSE_MORPH_MODS
#else
  UNICODE_MORPH_MODS
#endif
))>;
  };
  UNICODE(emoji_sweat_smile_macro, /* 😅 */
    #if OPERATING_SYSTEM == 'L'
      UNICODE_SEQ_LINUX(&kp _N1 &kp _NF &kp _N6 &kp _N0 &kp _N5)
    #elif OPERATING_SYSTEM == 'M'
      UNICODE_SEQ_MACOS(&kp _ND &kp _N8 &kp _N3 &kp _ND &kp _ND &kp _NE &kp _N0 &kp _N5)
    #elif OPERATING_SYSTEM == 'W'
      UNICODE_SEQ_WINDOWS(&kp _N0 &kp _N1 &kp _NF &kp _N6 &kp _N0 &kp _N5)
    #endif
  )
  emoji_sweat_smile: emoji_sweat_smile {
    compatible = "zmk,behavior-mod-morph";
    #binding-cells = <0>;
    bindings = <&emoji_sweat_smile_macro>, <&emoji_sweat_smile_macro>;
    mods = <(~(
#ifdef WORLD_USE_COMPOSE_FOR_emoji_sweat_smile
  COMPOSE_MORPH_MODS
#else
  UNICODE_MORPH_MODS
#endif
))>;
  };
  UNICODE(emoji_disappointed_macro, /* 😞 */
    #if OPERATING_SYSTEM == 'L'
      UNICODE_SEQ_LINUX(&kp _N1 &kp _NF &kp _N6 &kp _N1 &kp _NE)
    #elif OPERATING_SYSTEM == 'M'
      UNICODE_SEQ_MACOS(&kp _ND &kp _N8 &kp _N3 &kp _ND &kp _ND &kp _NE &kp _N1 &kp _NE)
    #elif OPERATING_SYSTEM == 'W'
      UNICODE_SEQ_WINDOWS(&kp _N0 &kp _N1 &kp _NF &kp _N6 &kp _N1 &kp _NE)
    #endif
  )
  emoji_disappointed: emoji_disappointed {
    compatible = "zmk,behavior-mod-morph";
    #binding-cells = <0>;
    bindings = <&emoji_disappointed_macro>, <&emoji_disappointed_macro>;
    mods = <(~(
#ifdef WORLD_USE_COMPOSE_FOR_emoji_disappointed
  COMPOSE_MORPH_MODS
#else
  UNICODE_MORPH_MODS
#endif
))>;
  };
  UNICODE(emoji_thinking_macro, /* 🤔 */
    #if OPERATING_SYSTEM == 'L'
      UNICODE_SEQ_LINUX(&kp _N1 &kp _NF &kp _N9 &kp _N1 &kp _N4)
    #elif OPERATING_SYSTEM == 'M'
      UNICODE_SEQ_MACOS(&kp _ND &kp _N8 &kp _N3 &kp _NE &kp _ND &kp _ND &kp _N1 &kp _N4)
    #elif OPERATING_SYSTEM == 'W'
      UNICODE_SEQ_WINDOWS(&kp _N0 &kp _N1 &kp _NF &kp _N9 &kp _N1 &kp _N4)
    #endif
  )
  emoji_thinking: emoji_thinking {
    compatible = "zmk,behavior-mod-morph";
    #binding-cells = <0>;
    bindings = <&emoji_thinking_macro>, <&emoji_thinking_macro>;
    mods = <(~(
#ifdef WORLD_USE_COMPOSE_FOR_emoji_thinking
  COMPOSE_MORPH_MODS
#else
  UNICODE_MORPH_MODS
#endif
))>;
  };
  UNICODE(emoji_person_tipping_hand_macro, /* 💁 */
    #if OPERATING_SYSTEM == 'L'
      UNICODE_SEQ_LINUX(&kp _N1 &kp _NF &kp _N4 &kp _N8 &kp _N1)
    #elif OPERATING_SYSTEM == 'M'
      UNICODE_SEQ_MACOS(&kp _ND &kp _N8 &kp _N3 &kp _ND &kp _ND &kp _NC &kp _N8 &kp _N1)
    #elif OPERATING_SYSTEM == 'W'
      UNICODE_SEQ_WINDOWS(&kp _N0 &kp _N1 &kp _NF &kp _N4 &kp _N8 &kp _N1)
    #endif
  )
  emoji_person_tipping_hand: emoji_person_tipping_hand {
    compatible = "zmk,behavior-mod-morph";
    #binding-cells = <0>;
    bindings = <&emoji_person_tipping_hand_macro>, <&emoji_person_tipping_hand_macro>;
    mods = <(~(
#ifdef WORLD_USE_COMPOSE_FOR_emoji_person_tipping_hand
  COMPOSE_MORPH_MODS
#else
  UNICODE_MORPH_MODS
#endif
))>;
  };
  UNICODE(emoji_person_gesturing_ok_macro, /* 🙆 */
    #if OPERATING_SYSTEM == 'L'
      UNICODE_SEQ_LINUX(&kp _N1 &kp _NF &kp _N6 &kp _N4 &kp _N6)
    #elif OPERATING_SYSTEM == 'M'
      UNICODE_SEQ_MACOS(&kp _ND &kp _N8 &kp _N3 &kp _ND &kp _ND &kp _NE &kp _N4 &kp _N6)
    #elif OPERATING_SYSTEM == 'W'
      UNICODE_SEQ_WINDOWS(&kp _N0 &kp _N1 &kp _NF &kp _N6 &kp _N4 &kp _N6)
    #endif
  )
  emoji_person_gesturing_ok: emoji_person_gesturing_ok {
    compatible = "zmk,behavior-mod-morph";
    #binding-cells = <0>;
    bindings = <&emoji_person_gesturing_ok_macro>, <&emoji_person_gesturing_ok_macro>;
    mods = <(~(
#ifdef WORLD_USE_COMPOSE_FOR_emoji_person_gesturing_ok
  COMPOSE_MORPH_MODS
#else
  UNICODE_MORPH_MODS
#endif
))>;
  };
  UNICODE(emoji_person_bowing_macro, /* 🙇 */
    #if OPERATING_SYSTEM == 'L'
      UNICODE_SEQ_LINUX(&kp _N1 &kp _NF &kp _N6 &kp _N4 &kp _N7)
    #elif OPERATING_SYSTEM == 'M'
      UNICODE_SEQ_MACOS(&kp _ND &kp _N8 &kp _N3 &kp _ND &kp _ND &kp _NE &kp _N4 &kp _N7)
    #elif OPERATING_SYSTEM == 'W'
      UNICODE_SEQ_WINDOWS(&kp _N0 &kp _N1 &kp _NF &kp _N6 &kp _N4 &kp _N7)
    #endif
  )
  emoji_person_bowing: emoji_person_bowing {
    compatible = "zmk,behavior-mod-morph";
    #binding-cells = <0>;
    bindings = <&emoji_person_bowing_macro>, <&emoji_person_bowing_macro>;
    mods = <(~(
#ifdef WORLD_USE_COMPOSE_FOR_emoji_person_bowing
  COMPOSE_MORPH_MODS
#else
  UNICODE_MORPH_MODS
#endif
))>;
  };
  UNICODE(emoji_person_raising_hand_macro, /* 🙋 */
    #if OPERATING_SYSTEM == 'L'
      UNICODE_SEQ_LINUX(&kp _N1 &kp _NF &kp _N6 &kp _N4 &kp _NB)
    #elif OPERATING_SYSTEM == 'M'
      UNICODE_SEQ_MACOS(&kp _ND &kp _N8 &kp _N3 &kp _ND &kp _ND &kp _NE &kp _N4 &kp _NB)
    #elif OPERATING_SYSTEM == 'W'
      UNICODE_SEQ_WINDOWS(&kp _N0 &kp _N1 &kp _NF &kp _N6 &kp _N4 &kp _NB)
    #endif
  )
  emoji_person_raising_hand: emoji_person_raising_hand {
    compatible = "zmk,behavior-mod-morph";
    #binding-cells = <0>;
    bindings = <&emoji_person_raising_hand_macro>, <&emoji_person_raising_hand_macro>;
    mods = <(~(
#ifdef WORLD_USE_COMPOSE_FOR_emoji_person_raising_hand
  COMPOSE_MORPH_MODS
#else
  UNICODE_MORPH_MODS
#endif
))>;
  };
  UNICODE(emoji_person_gesturing_no_macro, /* 🙅 */
    #if OPERATING_SYSTEM == 'L'
      UNICODE_SEQ_LINUX(&kp _N1 &kp _NF &kp _N6 &kp _N4 &kp _N5)
    #elif OPERATING_SYSTEM == 'M'
      UNICODE_SEQ_MACOS(&kp _ND &kp _N8 &kp _N3 &kp _ND &kp _ND &kp _NE &kp _N4 &kp _N5)
    #elif OPERATING_SYSTEM == 'W'
      UNICODE_SEQ_WINDOWS(&kp _N0 &kp _N1 &kp _NF &kp _N6 &kp _N4 &kp _N5)
    #endif
  )
  emoji_person_gesturing_no: emoji_person_gesturing_no {
    compatible = "zmk,behavior-mod-morph";
    #binding-cells = <0>;
    bindings = <&emoji_person_gesturing_no_macro>, <&emoji_person_gesturing_no_macro>;
    mods = <(~(
#ifdef WORLD_USE_COMPOSE_FOR_emoji_person_gesturing_no
  COMPOSE_MORPH_MODS
#else
  UNICODE_MORPH_MODS
#endif
))>;
  };
  UNICODE(emoji_person_shrugging_macro, /* 🤷 */
    #if OPERATING_SYSTEM == 'L'
      UNICODE_SEQ_LINUX(&kp _N1 &kp _NF &kp _N9 &kp _N3 &kp _N7)
    #elif OPERATING_SYSTEM == 'M'
      UNICODE_SEQ_MACOS(&kp _ND &kp _N8 &kp _N3 &kp _NE &kp _ND &kp _ND &kp _N3 &kp _N7)
    #elif OPERATING_SYSTEM == 'W'
      UNICODE_SEQ_WINDOWS(&kp _N0 &kp _N1 &kp _NF &kp _N9 &kp _N3 &kp _N7)
    #endif
  )
  emoji_person_shrugging: emoji_person_shrugging {
    compatible = "zmk,behavior-mod-morph";
    #binding-cells = <0>;
    bindings = <&emoji_person_shrugging_macro>, <&emoji_person_shrugging_macro>;
    mods = <(~(
#ifdef WORLD_USE_COMPOSE_FOR_emoji_person_shrugging
  COMPOSE_MORPH_MODS
#else
  UNICODE_MORPH_MODS
#endif
))>;
  };
  UNICODE(emoji_check_macro, /* ✅ */
    #if OPERATING_SYSTEM == 'L'
      UNICODE_SEQ_LINUX(&kp _N2 &kp _N7 &kp _N0 &kp _N5)
    #elif OPERATING_SYSTEM == 'M'
      UNICODE_SEQ_MACOS(&kp _N2 &kp _N7 &kp _N0 &kp _N5)
    #elif OPERATING_SYSTEM == 'W'
      UNICODE_SEQ_WINDOWS(&kp _N0 &kp _N2 &kp _N7 &kp _N0 &kp _N5)
    #endif
  )
  emoji_check: emoji_check {
    compatible = "zmk,behavior-mod-morph";
    #binding-cells = <0>;
    bindings = <&emoji_check_macro>, <&emoji_check_macro>;
    mods = <(~(
#ifdef WORLD_USE_COMPOSE_FOR_emoji_check
  COMPOSE_MORPH_MODS
#else
  UNICODE_MORPH_MODS
#endif
))>;
  };
  UNICODE(emoji_100_macro, /* 💯 */
    #if OPERATING_SYSTEM == 'L'
      UNICODE_SEQ_LINUX(&kp _N1 &kp _NF &kp _N4 &kp _NA &kp _NF)
    #elif OPERATING_SYSTEM == 'M'
      UNICODE_SEQ_MACOS(&kp _ND &kp _N8 &kp _N3 &kp _ND &kp _ND &kp _NC &kp _NA &kp _NF)
    #elif OPERATING_SYSTEM == 'W'
      UNICODE_SEQ_WINDOWS(&kp _N0 &kp _N1 &kp _NF &kp _N4 &kp _NA &kp _NF)
    #endif
  )
  emoji_100: emoji_100 {
    compatible = "zmk,behavior-mod-morph";
    #binding-cells = <0>;
    bindings = <&emoji_100_macro>, <&emoji_100_macro>;
    mods = <(~(
#ifdef WORLD_USE_COMPOSE_FOR_emoji_100
  COMPOSE_MORPH_MODS
#else
  UNICODE_MORPH_MODS
#endif
))>;
  };
  UNICODE(emoji_warning_macro, /* ⚠️ */
    #if OPERATING_SYSTEM == 'L'
      UNICODE_SEQ_LINUX(&kp _N2 &kp _N6 &kp _NA &kp _N0), <&macro_wait_time UNICODE_SEQ_DELAY>, UNICODE_SEQ_LINUX(&kp _NF &kp _NE &kp _N0 &kp _NF)
    #elif OPERATING_SYSTEM == 'M'
      UNICODE_SEQ_MACOS(&kp _N2 &kp _N6 &kp _NA &kp _N0), <&macro_wait_time UNICODE_SEQ_DELAY>, UNICODE_SEQ_MACOS(&kp _NF &kp _NE &kp _N0 &kp _NF)
    #elif OPERATING_SYSTEM == 'W'
      UNICODE_SEQ_WINDOWS(&kp _N0 &kp _N2 &kp _N6 &kp _NA &kp _N0), <&macro_wait_time UNICODE_SEQ_DELAY>, UNICODE_SEQ_WINDOWS(&kp _N0 &kp _NF &kp _NE &kp _N0 &kp _NF)
    #endif
  )
  emoji_warning: emoji_warning {
    compatible = "zmk,behavior-mod-morph";
    #binding-cells = <0>;
    bindings = <&emoji_warning_macro>, <&emoji_warning_macro>;
    mods = <(~(
#ifdef WORLD_USE_COMPOSE_FOR_emoji_warning
  COMPOSE_MORPH_MODS
#else
  UNICODE_MORPH_MODS
#endif
))>;
  };
  UNICODE(emoji_cross_macro, /* ❌ */
    #if OPERATING_SYSTEM == 'L'
      UNICODE_SEQ_LINUX(&kp _N2 &kp _N7 &kp _N4 &kp _NC)
    #elif OPERATING_SYSTEM == 'M'
      UNICODE_SEQ_MACOS(&kp _N2 &kp _N7 &kp _N4 &kp _NC)
    #elif OPERATING_SYSTEM == 'W'
      UNICODE_SEQ_WINDOWS(&kp _N0 &kp _N2 &kp _N7 &kp _N4 &kp _NC)
    #endif
  )
  emoji_cross: emoji_cross {
    compatible = "zmk,behavior-mod-morph";
    #binding-cells = <0>;
    bindings = <&emoji_cross_macro>, <&emoji_cross_macro>;
    mods = <(~(
#ifdef WORLD_USE_COMPOSE_FOR_emoji_cross
  COMPOSE_MORPH_MODS
#else
  UNICODE_MORPH_MODS
#endif
))>;
  };
  UNICODE(emoji_question_macro, /* ❓ */
    #if OPERATING_SYSTEM == 'L'
      UNICODE_SEQ_LINUX(&kp _N2 &kp _N7 &kp _N5 &kp _N3)
    #elif OPERATING_SYSTEM == 'M'
      UNICODE_SEQ_MACOS(&kp _N2 &kp _N7 &kp _N5 &kp _N3)
    #elif OPERATING_SYSTEM == 'W'
      UNICODE_SEQ_WINDOWS(&kp _N0 &kp _N2 &kp _N7 &kp _N5 &kp _N3)
    #endif
  )
  emoji_question: emoji_question {
    compatible = "zmk,behavior-mod-morph";
    #binding-cells = <0>;
    bindings = <&emoji_question_macro>, <&emoji_question_macro>;
    mods = <(~(
#ifdef WORLD_USE_COMPOSE_FOR_emoji_question
  COMPOSE_MORPH_MODS
#else
  UNICODE_MORPH_MODS
#endif
))>;
  };
  UNICODE(emoji_astronaut_macro, /* 🧑‍🚀 */
    #if OPERATING_SYSTEM == 'L'
      UNICODE_SEQ_LINUX(&kp _N1 &kp _NF &kp _N9 &kp _ND &kp _N1), <&macro_wait_time UNICODE_SEQ_DELAY>, UNICODE_SEQ_LINUX(&kp _N2 &kp _N0 &kp _N0 &kp _ND), UNICODE_SEQ_LINUX(&kp _N1 &kp _NF &kp _N6 &kp _N8 &kp _N0)
    #elif OPERATING_SYSTEM == 'M'
      UNICODE_SEQ_MACOS(&kp _ND &kp _N8 &kp _N3 &kp _NE &kp _ND &kp _ND &kp _ND &kp _N1), <&macro_wait_time UNICODE_SEQ_DELAY>, UNICODE_SEQ_MACOS(&kp _N2 &kp _N0 &kp _N0 &kp _ND), UNICODE_SEQ_MACOS(&kp _ND &kp _N8 &kp _N3 &kp _ND &kp _ND &kp _NE &kp _N8 &kp _N0)
    #elif OPERATING_SYSTEM == 'W'
      UNICODE_SEQ_WINDOWS(&kp _N0 &kp _N1 &kp _NF &kp _N9 &kp _ND &kp _N1), <&macro_wait_time UNICODE_SEQ_DELAY>, UNICODE_SEQ_WINDOWS(&kp _N0 &kp _N2 &kp _N0 &kp _N0 &kp _ND), UNICODE_SEQ_WINDOWS(&kp _N0 &kp _N1 &kp _NF &kp _N6 &kp _N8 &kp _N0)
    #endif
  )
  emoji_astronaut: emoji_astronaut {
    compatible = "zmk,behavior-mod-morph";
    #binding-cells = <0>;
    bindings = <&emoji_astronaut_macro>, <&emoji_astronaut_macro>;
    mods = <(~(
#ifdef WORLD_USE_COMPOSE_FOR_emoji_astronaut
  COMPOSE_MORPH_MODS
#else
  UNICODE_MORPH_MODS
#endif
))>;
  };
  UNICODE(emoji_nerd_macro, /* 🤓 */
    #if OPERATING_SYSTEM == 'L'
      UNICODE_SEQ_LINUX(&kp _N1 &kp _NF &kp _N9 &kp _N1 &kp _N3)
    #elif OPERATING_SYSTEM == 'M'
      UNICODE_SEQ_MACOS(&kp _ND &kp _N8 &kp _N3 &kp _NE &kp _ND &kp _ND &kp _N1 &kp _N3)
    #elif OPERATING_SYSTEM == 'W'
      UNICODE_SEQ_WINDOWS(&kp _N0 &kp _N1 &kp _NF &kp _N9 &kp _N1 &kp _N3)
    #endif
  )
  emoji_nerd: emoji_nerd {
    compatible = "zmk,behavior-mod-morph";
    #binding-cells = <0>;
    bindings = <&emoji_nerd_macro>, <&emoji_nerd_macro>;
    mods = <(~(
#ifdef WORLD_USE_COMPOSE_FOR_emoji_nerd
  COMPOSE_MORPH_MODS
#else
  UNICODE_MORPH_MODS
#endif
))>;
  };
  UNICODE(emoji_sparkles_macro, /* ✨ */
    #if OPERATING_SYSTEM == 'L'
      UNICODE_SEQ_LINUX(&kp _N2 &kp _N7 &kp _N2 &kp _N8)
    #elif OPERATING_SYSTEM == 'M'
      UNICODE_SEQ_MACOS(&kp _N2 &kp _N7 &kp _N2 &kp _N8)
    #elif OPERATING_SYSTEM == 'W'
      UNICODE_SEQ_WINDOWS(&kp _N0 &kp _N2 &kp _N7 &kp _N2 &kp _N8)
    #endif
  )
  emoji_sparkles: emoji_sparkles {
    compatible = "zmk,behavior-mod-morph";
    #binding-cells = <0>;
    bindings = <&emoji_sparkles_macro>, <&emoji_sparkles_macro>;
    mods = <(~(
#ifdef WORLD_USE_COMPOSE_FOR_emoji_sparkles
  COMPOSE_MORPH_MODS
#else
  UNICODE_MORPH_MODS
#endif
))>;
  };
  UNICODE(emoji_raised_hands_macro, /* 🙌 */
    #if OPERATING_SYSTEM == 'L'
      UNICODE_SEQ_LINUX(&kp _N1 &kp _NF &kp _N6 &kp _N4 &kp _NC)
    #elif OPERATING_SYSTEM == 'M'
      UNICODE_SEQ_MACOS(&kp _ND &kp _N8 &kp _N3 &kp _ND &kp _ND &kp _NE &kp _N4 &kp _NC)
    #elif OPERATING_SYSTEM == 'W'
      UNICODE_SEQ_WINDOWS(&kp _N0 &kp _N1 &kp _NF &kp _N6 &kp _N4 &kp _NC)
    #endif
  )
  emoji_raised_hands: emoji_raised_hands {
    compatible = "zmk,behavior-mod-morph";
    #binding-cells = <0>;
    bindings = <&emoji_raised_hands_macro>, <&emoji_raised_hands_macro>;
    mods = <(~(
#ifdef WORLD_USE_COMPOSE_FOR_emoji_raised_hands
  COMPOSE_MORPH_MODS
#else
  UNICODE_MORPH_MODS
#endif
))>;
  };
  UNICODE(emoji_point_up_macro, /* ☝️ */
    #if OPERATING_SYSTEM == 'L'
      UNICODE_SEQ_LINUX(&kp _N2 &kp _N6 &kp _N1 &kp _ND), <&macro_wait_time UNICODE_SEQ_DELAY>, UNICODE_SEQ_LINUX(&kp _NF &kp _NE &kp _N0 &kp _NF)
    #elif OPERATING_SYSTEM == 'M'
      UNICODE_SEQ_MACOS(&kp _N2 &kp _N6 &kp _N1 &kp _ND), <&macro_wait_time UNICODE_SEQ_DELAY>, UNICODE_SEQ_MACOS(&kp _NF &kp _NE &kp _N0 &kp _NF)
    #elif OPERATING_SYSTEM == 'W'
      UNICODE_SEQ_WINDOWS(&kp _N0 &kp _N2 &kp _N6 &kp _N1 &kp _ND), <&macro_wait_time UNICODE_SEQ_DELAY>, UNICODE_SEQ_WINDOWS(&kp _N0 &kp _NF &kp _NE &kp _N0 &kp _NF)
    #endif
  )
  emoji_point_up: emoji_point_up {
    compatible = "zmk,behavior-mod-morph";
    #binding-cells = <0>;
    bindings = <&emoji_point_up_macro>, <&emoji_point_up_macro>;
    mods = <(~(
#ifdef WORLD_USE_COMPOSE_FOR_emoji_point_up
  COMPOSE_MORPH_MODS
#else
  UNICODE_MORPH_MODS
#endif
))>;
  };
  UNICODE(emoji_thumbs_up_macro, /* 👍 */
    #if OPERATING_SYSTEM == 'L'
      UNICODE_SEQ_LINUX(&kp _N1 &kp _NF &kp _N4 &kp _N4 &kp _ND)
    #elif OPERATING_SYSTEM == 'M'
      UNICODE_SEQ_MACOS(&kp _ND &kp _N8 &kp _N3 &kp _ND &kp _ND &kp _NC &kp _N4 &kp _ND)
    #elif OPERATING_SYSTEM == 'W'
      UNICODE_SEQ_WINDOWS(&kp _N0 &kp _N1 &kp _NF &kp _N4 &kp _N4 &kp _ND)
    #endif
  )
  emoji_thumbs_up: emoji_thumbs_up {
    compatible = "zmk,behavior-mod-morph";
    #binding-cells = <0>;
    bindings = <&emoji_thumbs_up_macro>, <&emoji_thumbs_up_macro>;
    mods = <(~(
#ifdef WORLD_USE_COMPOSE_FOR_emoji_thumbs_up
  COMPOSE_MORPH_MODS
#else
  UNICODE_MORPH_MODS
#endif
))>;
  };

  //
  // characters
  //
  emoji_moon_complete: emoji_moon_complete {
    compatible = "zmk,behavior-mod-morph";
    #binding-cells = <0>;
    bindings = <&emoji_new_moon>, <&emoji_full_moon>;
    mods = <MOD_LSFT>;
  };
  emoji_moon_gibbous: emoji_moon_gibbous {
    compatible = "zmk,behavior-mod-morph";
    #binding-cells = <0>;
    bindings = <&emoji_waning_gibbous_moon>, <&emoji_waxing_gibbous_moon>;
    mods = <MOD_LSFT>;
  };
  emoji_moon_quarter: emoji_moon_quarter {
    compatible = "zmk,behavior-mod-morph";
    #binding-cells = <0>;
    bindings = <&emoji_last_quarter_moon>, <&emoji_first_quarter_moon>;
    mods = <MOD_LSFT>;
  };
  emoji_moon_crescent: emoji_moon_crescent {
    compatible = "zmk,behavior-mod-morph";
    #binding-cells = <0>;
    bindings = <&emoji_waning_crescent_moon>, <&emoji_waxing_crescent_moon>;
    mods = <MOD_LSFT>;
  };
  UNICODE(emoji_face_smile_up_macro, /* 🙂 */
    #if OPERATING_SYSTEM == 'L'
      UNICODE_SEQ_LINUX(&kp _N1 &kp _NF &kp _N6 &kp _N4 &kp _N2)
    #elif OPERATING_SYSTEM == 'M'
      UNICODE_SEQ_MACOS(&kp _ND &kp _N8 &kp _N3 &kp _ND &kp _ND &kp _NE &kp _N4 &kp _N2)
    #elif OPERATING_SYSTEM == 'W'
      UNICODE_SEQ_WINDOWS(&kp _N0 &kp _N1 &kp _NF &kp _N6 &kp _N4 &kp _N2)
    #endif
  )
  emoji_face_smile_up: emoji_face_smile_up {
    compatible = "zmk,behavior-mod-morph";
    #binding-cells = <0>;
    bindings = <&emoji_face_smile_up_macro>, <&emoji_face_smile_up_macro>;
    mods = <(~(
#ifdef WORLD_USE_COMPOSE_FOR_emoji_face_smile_up
  COMPOSE_MORPH_MODS
#else
  UNICODE_MORPH_MODS
#endif
))>;
  };
  UNICODE(emoji_face_smile_down_macro, /* 🙃 */
    #if OPERATING_SYSTEM == 'L'
      UNICODE_SEQ_LINUX(&kp _N1 &kp _NF &kp _N6 &kp _N4 &kp _N3)
    #elif OPERATING_SYSTEM == 'M'
      UNICODE_SEQ_MACOS(&kp _ND &kp _N8 &kp _N3 &kp _ND &kp _ND &kp _NE &kp _N4 &kp _N3)
    #elif OPERATING_SYSTEM == 'W'
      UNICODE_SEQ_WINDOWS(&kp _N0 &kp _N1 &kp _NF &kp _N6 &kp _N4 &kp _N3)
    #endif
  )
  emoji_face_smile_down: emoji_face_smile_down {
    compatible = "zmk,behavior-mod-morph";
    #binding-cells = <0>;
    bindings = <&emoji_face_smile_down_macro>, <&emoji_face_smile_down_macro>;
    mods = <(~(
#ifdef WORLD_USE_COMPOSE_FOR_emoji_face_smile_down
  COMPOSE_MORPH_MODS
#else
  UNICODE_MORPH_MODS
#endif
))>;
  };
  emoji_face_smile: emoji_face_smile {
    compatible = "zmk,behavior-mod-morph";
    #binding-cells = <0>;
    bindings = <&emoji_face_smile_up>, <&emoji_face_smile_down>;
    mods = <MOD_LSFT>;
  };
  emoji_face_laugh: emoji_face_laugh {
    compatible = "zmk,behavior-mod-morph";
    #binding-cells = <0>;
    bindings = <&emoji_joy>, <&emoji_rofl>;
    mods = <MOD_LSFT>;
  };
  emoji_face_eyes: emoji_face_eyes {
    compatible = "zmk,behavior-mod-morph";
    #binding-cells = <0>;
    bindings = <&emoji_star_struck>, <&emoji_love_struck>;
    mods = <MOD_LSFT>;
  };
  UNICODE(emoji_face_joke_wink_macro, /* 😉 */
    #if OPERATING_SYSTEM == 'L'
      UNICODE_SEQ_LINUX(&kp _N1 &kp _NF &kp _N6 &kp _N0 &kp _N9)
    #elif OPERATING_SYSTEM == 'M'
      UNICODE_SEQ_MACOS(&kp _ND &kp _N8 &kp _N3 &kp _ND &kp _ND &kp _NE &kp _N0 &kp _N9)
    #elif OPERATING_SYSTEM == 'W'
      UNICODE_SEQ_WINDOWS(&kp _N0 &kp _N1 &kp _NF &kp _N6 &kp _N0 &kp _N9)
    #endif
  )
  emoji_face_joke_wink: emoji_face_joke_wink {
    compatible = "zmk,behavior-mod-morph";
    #binding-cells = <0>;
    bindings = <&emoji_face_joke_wink_macro>, <&emoji_face_joke_wink_macro>;
    mods = <(~(
#ifdef WORLD_USE_COMPOSE_FOR_emoji_face_joke_wink
  COMPOSE_MORPH_MODS
#else
  UNICODE_MORPH_MODS
#endif
))>;
  };
  UNICODE(emoji_face_joke_tongue_macro, /* 😜 */
    #if OPERATING_SYSTEM == 'L'
      UNICODE_SEQ_LINUX(&kp _N1 &kp _NF &kp _N6 &kp _N1 &kp _NC)
    #elif OPERATING_SYSTEM == 'M'
      UNICODE_SEQ_MACOS(&kp _ND &kp _N8 &kp _N3 &kp _ND &kp _ND &kp _NE &kp _N1 &kp _NC)
    #elif OPERATING_SYSTEM == 'W'
      UNICODE_SEQ_WINDOWS(&kp _N0 &kp _N1 &kp _NF &kp _N6 &kp _N1 &kp _NC)
    #endif
  )
  emoji_face_joke_tongue: emoji_face_joke_tongue {
    compatible = "zmk,behavior-mod-morph";
    #binding-cells = <0>;
    bindings = <&emoji_face_joke_tongue_macro>, <&emoji_face_joke_tongue_macro>;
    mods = <(~(
#ifdef WORLD_USE_COMPOSE_FOR_emoji_face_joke_tongue
  COMPOSE_MORPH_MODS
#else
  UNICODE_MORPH_MODS
#endif
))>;
  };
  emoji_face_joke: emoji_face_joke {
    compatible = "zmk,behavior-mod-morph";
    #binding-cells = <0>;
    bindings = <&emoji_face_joke_wink>, <&emoji_face_joke_tongue>;
    mods = <MOD_LSFT>;
  };
  UNICODE(emoji_face_fear_scared_macro, /* 😨 */
    #if OPERATING_SYSTEM == 'L'
      UNICODE_SEQ_LINUX(&kp _N1 &kp _NF &kp _N6 &kp _N2 &kp _N8)
    #elif OPERATING_SYSTEM == 'M'
      UNICODE_SEQ_MACOS(&kp _ND &kp _N8 &kp _N3 &kp _ND &kp _ND &kp _NE &kp _N2 &kp _N8)
    #elif OPERATING_SYSTEM == 'W'
      UNICODE_SEQ_WINDOWS(&kp _N0 &kp _N1 &kp _NF &kp _N6 &kp _N2 &kp _N8)
    #endif
  )
  emoji_face_fear_scared: emoji_face_fear_scared {
    compatible = "zmk,behavior-mod-morph";
    #binding-cells = <0>;
    bindings = <&emoji_face_fear_scared_macro>, <&emoji_face_fear_scared_macro>;
    mods = <(~(
#ifdef WORLD_USE_COMPOSE_FOR_emoji_face_fear_scared
  COMPOSE_MORPH_MODS
#else
  UNICODE_MORPH_MODS
#endif
))>;
  };
  UNICODE(emoji_face_fear_scream_macro, /* 😱 */
    #if OPERATING_SYSTEM == 'L'
      UNICODE_SEQ_LINUX(&kp _N1 &kp _NF &kp _N6 &kp _N3 &kp _N1)
    #elif OPERATING_SYSTEM == 'M'
      UNICODE_SEQ_MACOS(&kp _ND &kp _N8 &kp _N3 &kp _ND &kp _ND &kp _NE &kp _N3 &kp _N1)
    #elif OPERATING_SYSTEM == 'W'
      UNICODE_SEQ_WINDOWS(&kp _N0 &kp _N1 &kp _NF &kp _N6 &kp _N3 &kp _N1)
    #endif
  )
  emoji_face_fear_scream: emoji_face_fear_scream {
    compatible = "zmk,behavior-mod-morph";
    #binding-cells = <0>;
    bindings = <&emoji_face_fear_scream_macro>, <&emoji_face_fear_scream_macro>;
    mods = <(~(
#ifdef WORLD_USE_COMPOSE_FOR_emoji_face_fear_scream
  COMPOSE_MORPH_MODS
#else
  UNICODE_MORPH_MODS
#endif
))>;
  };
  emoji_face_fear: emoji_face_fear {
    compatible = "zmk,behavior-mod-morph";
    #binding-cells = <0>;
    bindings = <&emoji_face_fear_scared>, <&emoji_face_fear_scream>;
    mods = <MOD_LSFT>;
  };
  UNICODE(emoji_face_surprise_dizzy_macro, /* 😵 */
    #if OPERATING_SYSTEM == 'L'
      UNICODE_SEQ_LINUX(&kp _N1 &kp _NF &kp _N6 &kp _N3 &kp _N5)
    #elif OPERATING_SYSTEM == 'M'
      UNICODE_SEQ_MACOS(&kp _ND &kp _N8 &kp _N3 &kp _ND &kp _ND &kp _NE &kp _N3 &kp _N5)
    #elif OPERATING_SYSTEM == 'W'
      UNICODE_SEQ_WINDOWS(&kp _N0 &kp _N1 &kp _NF &kp _N6 &kp _N3 &kp _N5)
    #endif
  )
  emoji_face_surprise_dizzy: emoji_face_surprise_dizzy {
    compatible = "zmk,behavior-mod-morph";
    #binding-cells = <0>;
    bindings = <&emoji_face_surprise_dizzy_macro>, <&emoji_face_surprise_dizzy_macro>;
    mods = <(~(
#ifdef WORLD_USE_COMPOSE_FOR_emoji_face_surprise_dizzy
  COMPOSE_MORPH_MODS
#else
  UNICODE_MORPH_MODS
#endif
))>;
  };
  emoji_face_surprise: emoji_face_surprise {
    compatible = "zmk,behavior-mod-morph";
    #binding-cells = <0>;
    bindings = <&emoji_shocked_face>, <&emoji_face_surprise_dizzy>;
    mods = <MOD_LSFT>;
  };
  UNICODE(emoji_gesture_attention_wave_macro, /* 👋 */
    #if OPERATING_SYSTEM == 'L'
      UNICODE_SEQ_LINUX(&kp _N1 &kp _NF &kp _N4 &kp _N4 &kp _NB)
    #elif OPERATING_SYSTEM == 'M'
      UNICODE_SEQ_MACOS(&kp _ND &kp _N8 &kp _N3 &kp _ND &kp _ND &kp _NC &kp _N4 &kp _NB)
    #elif OPERATING_SYSTEM == 'W'
      UNICODE_SEQ_WINDOWS(&kp _N0 &kp _N1 &kp _NF &kp _N4 &kp _N4 &kp _NB)
    #endif
  )
  emoji_gesture_attention_wave: emoji_gesture_attention_wave {
    compatible = "zmk,behavior-mod-morph";
    #binding-cells = <0>;
    bindings = <&emoji_gesture_attention_wave_macro>, <&emoji_gesture_attention_wave_macro>;
    mods = <(~(
#ifdef WORLD_USE_COMPOSE_FOR_emoji_gesture_attention_wave
  COMPOSE_MORPH_MODS
#else
  UNICODE_MORPH_MODS
#endif
))>;
  };
  emoji_gesture_attention: emoji_gesture_attention {
    compatible = "zmk,behavior-mod-morph";
    #binding-cells = <0>;
    bindings = <&emoji_snap_fingers>, <&emoji_gesture_attention_wave>;
    mods = <MOD_LSFT>;
  };
  UNICODE(emoji_gesture_approval_cool_macro, /* 😎 */
    #if OPERATING_SYSTEM == 'L'
      UNICODE_SEQ_LINUX(&kp _N1 &kp _NF &kp _N6 &kp _N0 &kp _NE)
    #elif OPERATING_SYSTEM == 'M'
      UNICODE_SEQ_MACOS(&kp _ND &kp _N8 &kp _N3 &kp _ND &kp _ND &kp _NE &kp _N0 &kp _NE)
    #elif OPERATING_SYSTEM == 'W'
      UNICODE_SEQ_WINDOWS(&kp _N0 &kp _N1 &kp _NF &kp _N6 &kp _N0 &kp _NE)
    #endif
  )
  emoji_gesture_approval_cool: emoji_gesture_approval_cool {
    compatible = "zmk,behavior-mod-morph";
    #binding-cells = <0>;
    bindings = <&emoji_gesture_approval_cool_macro>, <&emoji_gesture_approval_cool_macro>;
    mods = <(~(
#ifdef WORLD_USE_COMPOSE_FOR_emoji_gesture_approval_cool
  COMPOSE_MORPH_MODS
#else
  UNICODE_MORPH_MODS
#endif
))>;
  };
  emoji_gesture_approval: emoji_gesture_approval {
    compatible = "zmk,behavior-mod-morph";
    #binding-cells = <0>;
    bindings = <&emoji_ok_hand>, <&emoji_gesture_approval_cool>;
    mods = <MOD_LSFT>;
  };
  emoji_gesture_gratitude: emoji_gesture_gratitude {
    compatible = "zmk,behavior-mod-morph";
    #binding-cells = <0>;
    bindings = <&emoji_pray>, <&emoji_saluting_face>;
    mods = <MOD_LSFT>;
  };
  emoji_gesture_anxiety: emoji_gesture_anxiety {
    compatible = "zmk,behavior-mod-morph";
    #binding-cells = <0>;
    bindings = <&emoji_sweat_smile>, <&emoji_cold_sweat>;
    mods = <MOD_LSFT>;
  };
  UNICODE(emoji_gesture_despair_cry_macro, /* 😢 */
    #if OPERATING_SYSTEM == 'L'
      UNICODE_SEQ_LINUX(&kp _N1 &kp _NF &kp _N6 &kp _N2 &kp _N2)
    #elif OPERATING_SYSTEM == 'M'
      UNICODE_SEQ_MACOS(&kp _ND &kp _N8 &kp _N3 &kp _ND &kp _ND &kp _NE &kp _N2 &kp _N2)
    #elif OPERATING_SYSTEM == 'W'
      UNICODE_SEQ_WINDOWS(&kp _N0 &kp _N1 &kp _NF &kp _N6 &kp _N2 &kp _N2)
    #endif
  )
  emoji_gesture_despair_cry: emoji_gesture_despair_cry {
    compatible = "zmk,behavior-mod-morph";
    #binding-cells = <0>;
    bindings = <&emoji_gesture_despair_cry_macro>, <&emoji_gesture_despair_cry_macro>;
    mods = <(~(
#ifdef WORLD_USE_COMPOSE_FOR_emoji_gesture_despair_cry
  COMPOSE_MORPH_MODS
#else
  UNICODE_MORPH_MODS
#endif
))>;
  };
  emoji_gesture_despair: emoji_gesture_despair {
    compatible = "zmk,behavior-mod-morph";
    #binding-cells = <0>;
    bindings = <&emoji_disappointed>, <&emoji_gesture_despair_cry>;
    mods = <MOD_LSFT>;
  };
  emoji_gesture_curious: emoji_gesture_curious {
    compatible = "zmk,behavior-mod-morph";
    #binding-cells = <0>;
    bindings = <&emoji_thinking>, <&emoji_monocle_face>;
    mods = <MOD_LSFT>;
  };
  UNICODE(emoji_gesture_point_you_macro, /* 🫵 */
    #if OPERATING_SYSTEM == 'L'
      UNICODE_SEQ_LINUX(&kp _N1 &kp _NF &kp _NA &kp _NF &kp _N5)
    #elif OPERATING_SYSTEM == 'M'
      UNICODE_SEQ_MACOS(&kp _ND &kp _N8 &kp _N3 &kp _NE &kp _ND &kp _NE &kp _NF &kp _N5)
    #elif OPERATING_SYSTEM == 'W'
      UNICODE_SEQ_WINDOWS(&kp _N0 &kp _N1 &kp _NF &kp _NA &kp _NF &kp _N5)
    #endif
  )
  emoji_gesture_point_you: emoji_gesture_point_you {
    compatible = "zmk,behavior-mod-morph";
    #binding-cells = <0>;
    bindings = <&emoji_gesture_point_you_macro>, <&emoji_gesture_point_you_macro>;
    mods = <(~(
#ifdef WORLD_USE_COMPOSE_FOR_emoji_gesture_point_you
  COMPOSE_MORPH_MODS
#else
  UNICODE_MORPH_MODS
#endif
))>;
  };
  emoji_gesture_point: emoji_gesture_point {
    compatible = "zmk,behavior-mod-morph";
    #binding-cells = <0>;
    bindings = <&emoji_point_up>, <&emoji_gesture_point_you>;
    mods = <MOD_LSFT>;
  };
  UNICODE(emoji_gesture_thumbs_down_macro, /* 👎 */
    #if OPERATING_SYSTEM == 'L'
      UNICODE_SEQ_LINUX(&kp _N1 &kp _NF &kp _N4 &kp _N4 &kp _NE)
    #elif OPERATING_SYSTEM == 'M'
      UNICODE_SEQ_MACOS(&kp _ND &kp _N8 &kp _N3 &kp _ND &kp _ND &kp _NC &kp _N4 &kp _NE)
    #elif OPERATING_SYSTEM == 'W'
      UNICODE_SEQ_WINDOWS(&kp _N0 &kp _N1 &kp _NF &kp _N4 &kp _N4 &kp _NE)
    #endif
  )
  emoji_gesture_thumbs_down: emoji_gesture_thumbs_down {
    compatible = "zmk,behavior-mod-morph";
    #binding-cells = <0>;
    bindings = <&emoji_gesture_thumbs_down_macro>, <&emoji_gesture_thumbs_down_macro>;
    mods = <(~(
#ifdef WORLD_USE_COMPOSE_FOR_emoji_gesture_thumbs_down
  COMPOSE_MORPH_MODS
#else
  UNICODE_MORPH_MODS
#endif
))>;
  };
  emoji_gesture_thumbs: emoji_gesture_thumbs {
    compatible = "zmk,behavior-mod-morph";
    #binding-cells = <0>;
    bindings = <&emoji_thumbs_up>, <&emoji_gesture_thumbs_down>;
    mods = <MOD_LSFT>;
  };
  UNICODE(emoji_gesture_hands_clap_macro, /* 👏 */
    #if OPERATING_SYSTEM == 'L'
      UNICODE_SEQ_LINUX(&kp _N1 &kp _NF &kp _N4 &kp _N4 &kp _NF)
    #elif OPERATING_SYSTEM == 'M'
      UNICODE_SEQ_MACOS(&kp _ND &kp _N8 &kp _N3 &kp _ND &kp _ND &kp _NC &kp _N4 &kp _NF)
    #elif OPERATING_SYSTEM == 'W'
      UNICODE_SEQ_WINDOWS(&kp _N0 &kp _N1 &kp _NF &kp _N4 &kp _N4 &kp _NF)
    #endif
  )
  emoji_gesture_hands_clap: emoji_gesture_hands_clap {
    compatible = "zmk,behavior-mod-morph";
    #binding-cells = <0>;
    bindings = <&emoji_gesture_hands_clap_macro>, <&emoji_gesture_hands_clap_macro>;
    mods = <(~(
#ifdef WORLD_USE_COMPOSE_FOR_emoji_gesture_hands_clap
  COMPOSE_MORPH_MODS
#else
  UNICODE_MORPH_MODS
#endif
))>;
  };
  emoji_gesture_hands: emoji_gesture_hands {
    compatible = "zmk,behavior-mod-morph";
    #binding-cells = <0>;
    bindings = <&emoji_raised_hands>, <&emoji_gesture_hands_clap>;
    mods = <MOD_LSFT>;
  };
  UNICODE(emoji_theme_awesome_shine_macro, /* 🌟 */
    #if OPERATING_SYSTEM == 'L'
      UNICODE_SEQ_LINUX(&kp _N1 &kp _NF &kp _N3 &kp _N1 &kp _NF)
    #elif OPERATING_SYSTEM == 'M'
      UNICODE_SEQ_MACOS(&kp _ND &kp _N8 &kp _N3 &kp _NC &kp _ND &kp _NF &kp _N1 &kp _NF)
    #elif OPERATING_SYSTEM == 'W'
      UNICODE_SEQ_WINDOWS(&kp _N0 &kp _N1 &kp _NF &kp _N3 &kp _N1 &kp _NF)
    #endif
  )
  emoji_theme_awesome_shine: emoji_theme_awesome_shine {
    compatible = "zmk,behavior-mod-morph";
    #binding-cells = <0>;
    bindings = <&emoji_theme_awesome_shine_macro>, <&emoji_theme_awesome_shine_macro>;
    mods = <(~(
#ifdef WORLD_USE_COMPOSE_FOR_emoji_theme_awesome_shine
  COMPOSE_MORPH_MODS
#else
  UNICODE_MORPH_MODS
#endif
))>;
  };
  emoji_theme_awesome: emoji_theme_awesome {
    compatible = "zmk,behavior-mod-morph";
    #binding-cells = <0>;
    bindings = <&emoji_sparkles>, <&emoji_theme_awesome_shine>;
    mods = <MOD_LSFT>;
  };
  UNICODE(emoji_theme_magic_wand_macro, /* 🪄 */
    #if OPERATING_SYSTEM == 'L'
      UNICODE_SEQ_LINUX(&kp _N1 &kp _NF &kp _NA &kp _N8 &kp _N4)
    #elif OPERATING_SYSTEM == 'M'
      UNICODE_SEQ_MACOS(&kp _ND &kp _N8 &kp _N3 &kp _NE &kp _ND &kp _NE &kp _N8 &kp _N4)
    #elif OPERATING_SYSTEM == 'W'
      UNICODE_SEQ_WINDOWS(&kp _N0 &kp _N1 &kp _NF &kp _NA &kp _N8 &kp _N4)
    #endif
  )
  emoji_theme_magic_wand: emoji_theme_magic_wand {
    compatible = "zmk,behavior-mod-morph";
    #binding-cells = <0>;
    bindings = <&emoji_theme_magic_wand_macro>, <&emoji_theme_magic_wand_macro>;
    mods = <(~(
#ifdef WORLD_USE_COMPOSE_FOR_emoji_theme_magic_wand
  COMPOSE_MORPH_MODS
#else
  UNICODE_MORPH_MODS
#endif
))>;
  };
  UNICODE(emoji_theme_magic_wizard_macro, /* 🧙 */
    #if OPERATING_SYSTEM == 'L'
      UNICODE_SEQ_LINUX(&kp _N1 &kp _NF &kp _N9 &kp _ND &kp _N9)
    #elif OPERATING_SYSTEM == 'M'
      UNICODE_SEQ_MACOS(&kp _ND &kp _N8 &kp _N3 &kp _NE &kp _ND &kp _ND &kp _ND &kp _N9)
    #elif OPERATING_SYSTEM == 'W'
      UNICODE_SEQ_WINDOWS(&kp _N0 &kp _N1 &kp _NF &kp _N9 &kp _ND &kp _N9)
    #endif
  )
  emoji_theme_magic_wizard: emoji_theme_magic_wizard {
    compatible = "zmk,behavior-mod-morph";
    #binding-cells = <0>;
    bindings = <&emoji_theme_magic_wizard_macro>, <&emoji_theme_magic_wizard_macro>;
    mods = <(~(
#ifdef WORLD_USE_COMPOSE_FOR_emoji_theme_magic_wizard
  COMPOSE_MORPH_MODS
#else
  UNICODE_MORPH_MODS
#endif
))>;
  };
  emoji_theme_magic: emoji_theme_magic {
    compatible = "zmk,behavior-mod-morph";
    #binding-cells = <0>;
    bindings = <&emoji_theme_magic_wand>, <&emoji_theme_magic_wizard>;
    mods = <MOD_LSFT>;
  };
  emoji_theme_space: emoji_theme_space {
    compatible = "zmk,behavior-mod-morph";
    #binding-cells = <0>;
    bindings = <&emoji_rocket>, <&emoji_astronaut>;
    mods = <MOD_LSFT>;
  };
  emoji_theme_science: emoji_theme_science {
    compatible = "zmk,behavior-mod-morph";
    #binding-cells = <0>;
    bindings = <&emoji_nerd>, <&emoji_lab_coat>;
    mods = <MOD_LSFT>;
  };
  UNICODE(emoji_theme_strength_lifting_macro, /* 🏋️ */
    #if OPERATING_SYSTEM == 'L'
      UNICODE_SEQ_LINUX(&kp _N1 &kp _NF &kp _N3 &kp _NC &kp _NB), <&macro_wait_time UNICODE_SEQ_DELAY>, UNICODE_SEQ_LINUX(&kp _NF &kp _NE &kp _N0 &kp _NF)
    #elif OPERATING_SYSTEM == 'M'
      UNICODE_SEQ_MACOS(&kp _ND &kp _N8 &kp _N3 &kp _NC &kp _ND &kp _NF &kp _NC &kp _NB), <&macro_wait_time UNICODE_SEQ_DELAY>, UNICODE_SEQ_MACOS(&kp _NF &kp _NE &kp _N0 &kp _NF)
    #elif OPERATING_SYSTEM == 'W'
      UNICODE_SEQ_WINDOWS(&kp _N0 &kp _N1 &kp _NF &kp _N3 &kp _NC &kp _NB), <&macro_wait_time UNICODE_SEQ_DELAY>, UNICODE_SEQ_WINDOWS(&kp _N0 &kp _NF &kp _NE &kp _N0 &kp _NF)
    #endif
  )
  emoji_theme_strength_lifting: emoji_theme_strength_lifting {
    compatible = "zmk,behavior-mod-morph";
    #binding-cells = <0>;
    bindings = <&emoji_theme_strength_lifting_macro>, <&emoji_theme_strength_lifting_macro>;
    mods = <(~(
#ifdef WORLD_USE_COMPOSE_FOR_emoji_theme_strength_lifting
  COMPOSE_MORPH_MODS
#else
  UNICODE_MORPH_MODS
#endif
))>;
  };
  emoji_theme_strength: emoji_theme_strength {
    compatible = "zmk,behavior-mod-morph";
    #binding-cells = <0>;
    bindings = <&emoji_muscle>, <&emoji_theme_strength_lifting>;
    mods = <MOD_LSFT>;
  };
  UNICODE(emoji_theme_effort_juggle_macro, /* 🤹 */
    #if OPERATING_SYSTEM == 'L'
      UNICODE_SEQ_LINUX(&kp _N1 &kp _NF &kp _N9 &kp _N3 &kp _N9)
    #elif OPERATING_SYSTEM == 'M'
      UNICODE_SEQ_MACOS(&kp _ND &kp _N8 &kp _N3 &kp _NE &kp _ND &kp _ND &kp _N3 &kp _N9)
    #elif OPERATING_SYSTEM == 'W'
      UNICODE_SEQ_WINDOWS(&kp _N0 &kp _N1 &kp _NF &kp _N9 &kp _N3 &kp _N9)
    #endif
  )
  emoji_theme_effort_juggle: emoji_theme_effort_juggle {
    compatible = "zmk,behavior-mod-morph";
    #binding-cells = <0>;
    bindings = <&emoji_theme_effort_juggle_macro>, <&emoji_theme_effort_juggle_macro>;
    mods = <(~(
#ifdef WORLD_USE_COMPOSE_FOR_emoji_theme_effort_juggle
  COMPOSE_MORPH_MODS
#else
  UNICODE_MORPH_MODS
#endif
))>;
  };
  emoji_theme_effort: emoji_theme_effort {
    compatible = "zmk,behavior-mod-morph";
    #binding-cells = <0>;
    bindings = <&emoji_person_climbing>, <&emoji_theme_effort_juggle>;
    mods = <MOD_LSFT>;
  };
  UNICODE(emoji_theme_nature_water_macro, /* 🌊 */
    #if OPERATING_SYSTEM == 'L'
      UNICODE_SEQ_LINUX(&kp _N1 &kp _NF &kp _N3 &kp _N0 &kp _NA)
    #elif OPERATING_SYSTEM == 'M'
      UNICODE_SEQ_MACOS(&kp _ND &kp _N8 &kp _N3 &kp _NC &kp _ND &kp _NF &kp _N0 &kp _NA)
    #elif OPERATING_SYSTEM == 'W'
      UNICODE_SEQ_WINDOWS(&kp _N0 &kp _N1 &kp _NF &kp _N3 &kp _N0 &kp _NA)
    #endif
  )
  emoji_theme_nature_water: emoji_theme_nature_water {
    compatible = "zmk,behavior-mod-morph";
    #binding-cells = <0>;
    bindings = <&emoji_theme_nature_water_macro>, <&emoji_theme_nature_water_macro>;
    mods = <(~(
#ifdef WORLD_USE_COMPOSE_FOR_emoji_theme_nature_water
  COMPOSE_MORPH_MODS
#else
  UNICODE_MORPH_MODS
#endif
))>;
  };
  emoji_theme_nature: emoji_theme_nature {
    compatible = "zmk,behavior-mod-morph";
    #binding-cells = <0>;
    bindings = <&emoji_fire>, <&emoji_theme_nature_water>;
    mods = <MOD_LSFT>;
  };
  UNICODE(emoji_theme_love_heart_macro, /* ❤️ */
    #if OPERATING_SYSTEM == 'L'
      UNICODE_SEQ_LINUX(&kp _N2 &kp _N7 &kp _N6 &kp _N4), <&macro_wait_time UNICODE_SEQ_DELAY>, UNICODE_SEQ_LINUX(&kp _NF &kp _NE &kp _N0 &kp _NF)
    #elif OPERATING_SYSTEM == 'M'
      UNICODE_SEQ_MACOS(&kp _N2 &kp _N7 &kp _N6 &kp _N4), <&macro_wait_time UNICODE_SEQ_DELAY>, UNICODE_SEQ_MACOS(&kp _NF &kp _NE &kp _N0 &kp _NF)
    #elif OPERATING_SYSTEM == 'W'
      UNICODE_SEQ_WINDOWS(&kp _N0 &kp _N2 &kp _N7 &kp _N6 &kp _N4), <&macro_wait_time UNICODE_SEQ_DELAY>, UNICODE_SEQ_WINDOWS(&kp _N0 &kp _NF &kp _NE &kp _N0 &kp _NF)
    #endif
  )
  emoji_theme_love_heart: emoji_theme_love_heart {
    compatible = "zmk,behavior-mod-morph";
    #binding-cells = <0>;
    bindings = <&emoji_theme_love_heart_macro>, <&emoji_theme_love_heart_macro>;
    mods = <(~(
#ifdef WORLD_USE_COMPOSE_FOR_emoji_theme_love_heart
  COMPOSE_MORPH_MODS
#else
  UNICODE_MORPH_MODS
#endif
))>;
  };
  UNICODE(emoji_theme_love_face_macro, /* 🥰 */
    #if OPERATING_SYSTEM == 'L'
      UNICODE_SEQ_LINUX(&kp _N1 &kp _NF &kp _N9 &kp _N7 &kp _N0)
    #elif OPERATING_SYSTEM == 'M'
      UNICODE_SEQ_MACOS(&kp _ND &kp _N8 &kp _N3 &kp _NE &kp _ND &kp _ND &kp _N7 &kp _N0)
    #elif OPERATING_SYSTEM == 'W'
      UNICODE_SEQ_WINDOWS(&kp _N0 &kp _N1 &kp _NF &kp _N9 &kp _N7 &kp _N0)
    #endif
  )
  emoji_theme_love_face: emoji_theme_love_face {
    compatible = "zmk,behavior-mod-morph";
    #binding-cells = <0>;
    bindings = <&emoji_theme_love_face_macro>, <&emoji_theme_love_face_macro>;
    mods = <(~(
#ifdef WORLD_USE_COMPOSE_FOR_emoji_theme_love_face
  COMPOSE_MORPH_MODS
#else
  UNICODE_MORPH_MODS
#endif
))>;
  };
  emoji_theme_love: emoji_theme_love {
    compatible = "zmk,behavior-mod-morph";
    #binding-cells = <0>;
    bindings = <&emoji_theme_love_heart>, <&emoji_theme_love_face>;
    mods = <MOD_LSFT>;
  };
  UNICODE(emoji_theme_party_face_macro, /* 🥳 */
    #if OPERATING_SYSTEM == 'L'
      UNICODE_SEQ_LINUX(&kp _N1 &kp _NF &kp _N9 &kp _N7 &kp _N3)
    #elif OPERATING_SYSTEM == 'M'
      UNICODE_SEQ_MACOS(&kp _ND &kp _N8 &kp _N3 &kp _NE &kp _ND &kp _ND &kp _N7 &kp _N3)
    #elif OPERATING_SYSTEM == 'W'
      UNICODE_SEQ_WINDOWS(&kp _N0 &kp _N1 &kp _NF &kp _N9 &kp _N7 &kp _N3)
    #endif
  )
  emoji_theme_party_face: emoji_theme_party_face {
    compatible = "zmk,behavior-mod-morph";
    #binding-cells = <0>;
    bindings = <&emoji_theme_party_face_macro>, <&emoji_theme_party_face_macro>;
    mods = <(~(
#ifdef WORLD_USE_COMPOSE_FOR_emoji_theme_party_face
  COMPOSE_MORPH_MODS
#else
  UNICODE_MORPH_MODS
#endif
))>;
  };
  emoji_theme_party: emoji_theme_party {
    compatible = "zmk,behavior-mod-morph";
    #binding-cells = <0>;
    bindings = <&emoji_tada>, <&emoji_theme_party_face>;
    mods = <MOD_LSFT>;
  };
  UNICODE(emoji_theme_game_dart_macro, /* 🎯 */
    #if OPERATING_SYSTEM == 'L'
      UNICODE_SEQ_LINUX(&kp _N1 &kp _NF &kp _N3 &kp _NA &kp _NF)
    #elif OPERATING_SYSTEM == 'M'
      UNICODE_SEQ_MACOS(&kp _ND &kp _N8 &kp _N3 &kp _NC &kp _ND &kp _NF &kp _NA &kp _NF)
    #elif OPERATING_SYSTEM == 'W'
      UNICODE_SEQ_WINDOWS(&kp _N0 &kp _N1 &kp _NF &kp _N3 &kp _NA &kp _NF)
    #endif
  )
  emoji_theme_game_dart: emoji_theme_game_dart {
    compatible = "zmk,behavior-mod-morph";
    #binding-cells = <0>;
    bindings = <&emoji_theme_game_dart_macro>, <&emoji_theme_game_dart_macro>;
    mods = <(~(
#ifdef WORLD_USE_COMPOSE_FOR_emoji_theme_game_dart
  COMPOSE_MORPH_MODS
#else
  UNICODE_MORPH_MODS
#endif
))>;
  };
  UNICODE(emoji_theme_game_dice_macro, /* 🎲 */
    #if OPERATING_SYSTEM == 'L'
      UNICODE_SEQ_LINUX(&kp _N1 &kp _NF &kp _N3 &kp _NB &kp _N2)
    #elif OPERATING_SYSTEM == 'M'
      UNICODE_SEQ_MACOS(&kp _ND &kp _N8 &kp _N3 &kp _NC &kp _ND &kp _NF &kp _NB &kp _N2)
    #elif OPERATING_SYSTEM == 'W'
      UNICODE_SEQ_WINDOWS(&kp _N0 &kp _N1 &kp _NF &kp _N3 &kp _NB &kp _N2)
    #endif
  )
  emoji_theme_game_dice: emoji_theme_game_dice {
    compatible = "zmk,behavior-mod-morph";
    #binding-cells = <0>;
    bindings = <&emoji_theme_game_dice_macro>, <&emoji_theme_game_dice_macro>;
    mods = <(~(
#ifdef WORLD_USE_COMPOSE_FOR_emoji_theme_game_dice
  COMPOSE_MORPH_MODS
#else
  UNICODE_MORPH_MODS
#endif
))>;
  };
  emoji_theme_game: emoji_theme_game {
    compatible = "zmk,behavior-mod-morph";
    #binding-cells = <0>;
    bindings = <&emoji_theme_game_dart>, <&emoji_theme_game_dice>;
    mods = <MOD_LSFT>;
  };
  UNICODE(emoji_theme_trend_up_macro, /* 📈 */
    #if OPERATING_SYSTEM == 'L'
      UNICODE_SEQ_LINUX(&kp _N1 &kp _NF &kp _N4 &kp _NC &kp _N8)
    #elif OPERATING_SYSTEM == 'M'
      UNICODE_SEQ_MACOS(&kp _ND &kp _N8 &kp _N3 &kp _ND &kp _ND &kp _NC &kp _NC &kp _N8)
    #elif OPERATING_SYSTEM == 'W'
      UNICODE_SEQ_WINDOWS(&kp _N0 &kp _N1 &kp _NF &kp _N4 &kp _NC &kp _N8)
    #endif
  )
  emoji_theme_trend_up: emoji_theme_trend_up {
    compatible = "zmk,behavior-mod-morph";
    #binding-cells = <0>;
    bindings = <&emoji_theme_trend_up_macro>, <&emoji_theme_trend_up_macro>;
    mods = <(~(
#ifdef WORLD_USE_COMPOSE_FOR_emoji_theme_trend_up
  COMPOSE_MORPH_MODS
#else
  UNICODE_MORPH_MODS
#endif
))>;
  };
  UNICODE(emoji_theme_trend_down_macro, /* 📉 */
    #if OPERATING_SYSTEM == 'L'
      UNICODE_SEQ_LINUX(&kp _N1 &kp _NF &kp _N4 &kp _NC &kp _N9)
    #elif OPERATING_SYSTEM == 'M'
      UNICODE_SEQ_MACOS(&kp _ND &kp _N8 &kp _N3 &kp _ND &kp _ND &kp _NC &kp _NC &kp _N9)
    #elif OPERATING_SYSTEM == 'W'
      UNICODE_SEQ_WINDOWS(&kp _N0 &kp _N1 &kp _NF &kp _N4 &kp _NC &kp _N9)
    #endif
  )
  emoji_theme_trend_down: emoji_theme_trend_down {
    compatible = "zmk,behavior-mod-morph";
    #binding-cells = <0>;
    bindings = <&emoji_theme_trend_down_macro>, <&emoji_theme_trend_down_macro>;
    mods = <(~(
#ifdef WORLD_USE_COMPOSE_FOR_emoji_theme_trend_down
  COMPOSE_MORPH_MODS
#else
  UNICODE_MORPH_MODS
#endif
))>;
  };
  emoji_theme_trend: emoji_theme_trend {
    compatible = "zmk,behavior-mod-morph";
    #binding-cells = <0>;
    bindings = <&emoji_theme_trend_up>, <&emoji_theme_trend_down>;
    mods = <MOD_LSFT>;
  };
  UNICODE(emoji_theme_sigh_fail_macro, /* 🤦 */
    #if OPERATING_SYSTEM == 'L'
      UNICODE_SEQ_LINUX(&kp _N1 &kp _NF &kp _N9 &kp _N2 &kp _N6)
    #elif OPERATING_SYSTEM == 'M'
      UNICODE_SEQ_MACOS(&kp _ND &kp _N8 &kp _N3 &kp _NE &kp _ND &kp _ND &kp _N2 &kp _N6)
    #elif OPERATING_SYSTEM == 'W'
      UNICODE_SEQ_WINDOWS(&kp _N0 &kp _N1 &kp _NF &kp _N9 &kp _N2 &kp _N6)
    #endif
  )
  emoji_theme_sigh_fail: emoji_theme_sigh_fail {
    compatible = "zmk,behavior-mod-morph";
    #binding-cells = <0>;
    bindings = <&emoji_theme_sigh_fail_macro>, <&emoji_theme_sigh_fail_macro>;
    mods = <(~(
#ifdef WORLD_USE_COMPOSE_FOR_emoji_theme_sigh_fail
  COMPOSE_MORPH_MODS
#else
  UNICODE_MORPH_MODS
#endif
))>;
  };
  emoji_theme_sigh: emoji_theme_sigh {
    compatible = "zmk,behavior-mod-morph";
    #binding-cells = <0>;
    bindings = <&emoji_person_shrugging>, <&emoji_theme_sigh_fail>;
    mods = <MOD_LSFT>;
  };
};
