/*
 * Copyright (c) 2020 The ZMK Contributors
 * Copyright (c) 2025 Innaworks Development Limited, trading as MoErgo
 *
 * SPDX-License-Identifier: MIT
 */


/* THIS FILE WAS GENERATED BY GLOVE80 LAYOUT EDITOR
 *
 * This file was generated automatically. You may or may not want to
 * edit it directly.
 *
 * MODIFIED FOR MAGIC 8 (GACS/CAGS TOGGLE):
 * - Layers 0-13: macOS CAGS (Ctrl on pinky, Cmd on middle)
 * - Layers 14-24: macOS SHARED (used by both CAGS and GACS)
 * - Layers 25-38: macOS GACS (Cmd on pinky, Ctrl on middle)
 * - Layers 39-63: Linux GACS (Super on pinky, Ctrl on middle)
 */

#include <behaviors.dtsi>
/* Include all behavior includes needed */
#include <dt-bindings/zmk/outputs.h>
#include <dt-bindings/zmk/keys.h>
#include <dt-bindings/zmk/bt.h>
#include <dt-bindings/zmk/rgb.h>

/* On demand includes */
#include <dt-bindings/zmk/pointing.h>

/* Helper Macros and Layer Definitions */
#include "includes/helpers.dtsi"

/* Custom Device-tree Nodes (RGB indicators, etc.) */
#include "includes/custom-nodes.dtsi"

/* Custom Behaviors, Macros, and World Characters */
#include "includes/behaviors.dtsi"

/* Combos */
#include "includes/combos.dtsi"

/* Automatically generated keymap */
/ {
    keymap {
        compatible = "zmk,keymap";

        /* ========================================================================
         * macOS CAGS Layers (0-13) - Ctrl on pinky, Cmd on middle
         * ======================================================================== */

        /* Base Layer: QWERTY (layer 0) */
        #include "includes/layers/base-layers.dtsi"

        /* Typing Layer (layer 1) */
        #include "includes/layers/typing-layer.dtsi"

        /* Finger Layers (layers 2-9): Left/Right Pinky, Ringy, Middy, Index */
        #include "includes/layers/finger-layers.dtsi"

        /* Function Layers (layers 10-13): Cursor, Number, Function, Symbol */
        #include "includes/layers/function-layers.dtsi"

        /* ========================================================================
         * macOS SHARED Layers (14-24) - Used by both CAGS and GACS
         * ======================================================================== */

        /* Shared Layers: Emoji, World, System (layers 14-16) */
        /* Mouse Layers: Mouse, MouseFine, MouseSlow, MouseFast, MouseWarp (layers 17-21) */
        /* Special Layers: Factory, Lower, Magic (layers 22-24) */
        #include "includes/layers/mouse-layers.dtsi"
        #include "includes/layers/special-layers.dtsi"

        /* ========================================================================
         * macOS GACS Layers (25-38) - Cmd on pinky, Ctrl on middle
         * ======================================================================== */

        /* Base Layer: QWERTY_GACS (layer 25) */
        #include "includes/layers/base-layers-gacs.dtsi"

        /* Typing Layer GACS (layer 26) */
        #include "includes/layers/typing-layer-gacs.dtsi"

        /* Finger Layers GACS (layers 27-34) */
        #include "includes/layers/finger-layers-gacs.dtsi"

        /* Function Layers GACS (layers 35-38): Cursor, Number, Function, Symbol */
        #include "includes/layers/function-layers-gacs.dtsi"

        /* ========================================================================
         * Linux GACS Layers (39-63) - Super on pinky, Ctrl on middle
         * ======================================================================== */

        /* Base Layer: QWERTY_Linux (layer 39) */
        #include "includes/layers/base-layers-linux.dtsi"

        /* Typing Layer Linux (layer 40) */
        #include "includes/layers/typing-layer-linux.dtsi"

        /* Finger Layers Linux (layers 41-48) */
        #include "includes/layers/finger-layers-linux.dtsi"

        /* Function Layers Linux (layers 49-54): Cursor, Number, Function, Emoji, World, Symbol */
        /* System Layer Linux (layer 55) */
        #include "includes/layers/function-layers-linux.dtsi"

        /* Mouse Layers Linux (layers 56-60) */
        /* Special Layers Linux: Factory, Lower, Magic (layers 61-63) */
        #include "includes/layers/mouse-layers-linux.dtsi"
        #include "includes/layers/special-layers-linux.dtsi"

    };
};
